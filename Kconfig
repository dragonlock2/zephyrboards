## Kconfig
```kconfig
menu "zephyrboards"

rsource "samples/Kconfig"
rsource "drivers/Kconfig"

endmenu
```

## boards/arm/6wire/6wire_defconfig
```kconfig
CONFIG_SOC_SERIES_SAMD21=y
CONFIG_SOC_PART_NUMBER_SAMD21G18A=y
CONFIG_BOARD_6WIRE=y

CONFIG_CORTEX_M_SYSTICK=y
CONFIG_SOC_ATMEL_SAMD_XOSC32K=y
CONFIG_SOC_ATMEL_SAMD_XOSC32K_AS_MAIN=y

CONFIG_CONSOLE=y
CONFIG_UART_CONSOLE=y
CONFIG_SERIAL=y
CONFIG_UART_SAM0=y
CONFIG_UART_INTERRUPT_DRIVEN=y

CONFIG_GPIO=y
CONFIG_GPIO_SAM0=y

CONFIG_BUILD_OUTPUT_HEX=y
```

## boards/arm/efm32wg/Kconfig.board
```kconfig
config BOARD_EFM32WG
    bool "efm32wg breakout board"
    depends on SOC_SERIES_EFM32WG
    select SOC_PART_NUMBER_EFM32WG332F256
```

## boards/arm/efm32wg/Kconfig.defconfig
```kconfig
config SOC_PART_NUMBER_EFM32WG332F256
    bool
    depends on SOC_SERIES_EFM32WG

config SOC_PART_NUMBER
    default "EFM32WG332F256" if SOC_PART_NUMBER_EFM32WG332F256

config LEUART_GECKO
    default y
    depends on SERIAL

if BOARD_EFM32WG

config BOARD
    default "efm32wg"

config CMU_HFXO_FREQ
    default 48000000

config CMU_LFXO_FREQ
    default 32768

config CMU_HFRCO_FREQ
    default 14000000

endif # BOARD_EFM32WG
```

## boards/arm/jabican_usb_pro/Kconfig.board
```kconfig
config BOARD_JABICAN_USB_PRO
    bool "JABICAN-USB Pro"
    depends on SOC_SERIES_KINETIS_K2X
    select SOC_PART_NUMBER_MK22FN512VLH12
```

## boards/arm/jabican_usb_pro/Kconfig.defconfig
```kconfig
if BOARD_JABICAN_USB_PRO

config BOARD
    default "jabican_usb_pro"

config OSC_XTAL0_FREQ
    default 8000000

config MCG_PRDIV0
    default 0x1

config MCG_VDIV0
    default 0x6

config MCG_FCRDIV
    default 0

config CAN_MCUX_FLEXCAN
    default y
    depends on CAN

config NUM_IRQS
    default 81

endif # BOARD_JABICAN_USB_PRO
```

## boards/arm/jabican_usb_pro/jabican_usb_pro_defconfig
```kconfig
CONFIG_SOC_MK22F51212=y
CONFIG_SOC_SERIES_KINETIS_K2X=y
CONFIG_CORTEX_M_SYSTICK=y
CONFIG_PINCTRL=y
CONFIG_GPIO=y

CONFIG_CONSOLE=y
CONFIG_UART_CONSOLE=y
CONFIG_SERIAL=y

CONFIG_SYS_CLOCK_HW_CYCLES_PER_SEC=120000000
CONFIG_OSC_LOW_POWER=y

CONFIG_BUILD_OUTPUT_HEX=y
```

## boards/arm/k66f_breakout/Kconfig.board
```kconfig
config BOARD_K66F_BREAKOUT
	bool "MK66F Breakout Board"
	depends on SOC_SERIES_KINETIS_K6X
	select SOC_PART_NUMBER_MK66FN2M0VMD18
```

## boards/arm/k66f_breakout/Kconfig.defconfig
```kconfig
if BOARD_K66F_BREAKOUT

# bare minimum
config BOARD
	default "k66f_breakout"

config OSC_XTAL0_FREQ
	default 12000000

config MCG_PRDIV0
	default 0x0

config MCG_VDIV0
	default 0x4 # 0xe for 180MHz

config MCG_FCRDIV
	default 1

config UART_MCUX
	default y
	depends on SERIAL

# supported peripherals
config ADC_MCUX_ADC16
	default y
	depends on ADC

config TEMP_KINETIS
	default y
	depends on SENSOR && ADC

config I2C_MCUX
	default y
	depends on I2C

config CAN_MCUX_FLEXCAN
	default y
	depends on CAN

config USB_KINETIS
	default y
	depends on USB_DEVICE_DRIVER

if NETWORKING

config NET_L2_ETHERNET
	default y

config ETH_MCUX
	default y

config ETH_MCUX_RMII_EXT_CLK
	default y

endif # NETWORKING

endif # BOARD_K66F_BREAKOUT
```

## boards/arm/k66f_breakout/k66f_breakout_defconfig
```kconfig
# bare minimum
CONFIG_SOC_MK66F18=y
CONFIG_SOC_SERIES_KINETIS_K6X=y
CONFIG_BOARD_K66F_BREAKOUT=y
CONFIG_CORTEX_M_SYSTICK=y
CONFIG_GPIO=y
CONFIG_PINCTRL=y
CONFIG_SYS_CLOCK_HW_CYCLES_PER_SEC=120000000
CONFIG_OSC_LOW_POWER=y

CONFIG_CONSOLE=y
CONFIG_UART_CONSOLE=y
CONFIG_SERIAL=y

CONFIG_ARM_MPU=y
CONFIG_HW_STACK_PROTECTION=y

CONFIG_BUILD_OUTPUT_HEX=y
```

## boards/arm/k66f_usbhs/Kconfig.board
```kconfig
config BOARD_K66F_USBHS
    bool "k66f_usbhs"
    depends on SOC_MK66F18
    depends on SOC_SERIES_KINETIS_K6X
    select SOC_PART_NUMBER_MK66FN2M0VMD18
```

## boards/arm/k66f_usbhs/Kconfig.defconfig
```kconfig
if BOARD_K66F_USBHS

config BOARD
    default "k66f_usbhs"

config SYS_CLOCK_HW_CYCLES_PER_SEC
    default 180000000 if K6X_HSRUN
    default 120000000

config OSC_XTAL0_FREQ
    default 12000000

config MCG_PRDIV0
    default 0x0

config MCG_VDIV0
    default 0xe if K6X_HSRUN
    default 0x4

# MCGOUTCLK = 12MHz/1*30/2 = 180MHz
# MCGOUTCLK = 12MHz/1*20/2 = 120MHz

endif # BOARD_K66F_USBHS
```

## boards/arm/k66f_usbhs/k66f_usbhs_defconfig
```kconfig
CONFIG_SOC_MK66F18=y
CONFIG_SOC_SERIES_KINETIS_K6X=y
CONFIG_BOARD_K66F_USBHS=y
CONFIG_SYS_CLOCK_HW_CYCLES_PER_SEC=180000000
CONFIG_OSC_LOW_POWER=y

# TODO allow USB HS and SDHC access and enable
CONFIG_ARM_MPU=n
CONFIG_HW_STACK_PROTECTION=n

CONFIG_SERIAL=y
CONFIG_CONSOLE=y
CONFIG_UART_CONSOLE=y

CONFIG_BUILD_OUTPUT_HEX=y
```

## boards/arm/leveler/Kconfig.board
```kconfig
config BOARD_LEVELER
    bool "UR@B leveler training board"
    depends on SOC_STM32F401XE
```

## boards/arm/leveler/Kconfig.defconfig
```kconfig
if BOARD_LEVELER

config BOARD
    default "leveler"

config SPI_STM32_INTERRUPT
    default y
    depends on SPI

endif # BOARD_LEVELER
```

## boards/arm/leveler/leveler_defconfig
```kconfig
CONFIG_SOC_SERIES_STM32F4X=y
CONFIG_SOC_STM32F401XE=y

CONFIG_ARM_MPU=y
CONFIG_HW_STACK_PROTECTION=y

CONFIG_CLOCK_CONTROL=y
CONFIG_PINCTRL=y

CONFIG_SERIAL=y
CONFIG_CONSOLE=y
CONFIG_UART_CONSOLE=y

CONFIG_GPIO=y

CONFIG_SYS_CLOCK_HW_CYCLES_PER_SEC=72000000
```

## boards/arm/lpc845_lin/Kconfig.board
```kconfig
config BOARD_LPC845_LIN
    bool "LPC845 LIN Breakout"
    depends on SOC_SERIES_LPC84X
    select SOC_PART_NUMBER_LPC845M301JHI33
```

## boards/arm/lpc845_lin/Kconfig.defconfig
```kconfig
if BOARD_LPC845_LIN

config BOARD
    default "LPC845 LIN Breakout"

endif # BOARD_LPC845_LIN
```

## boards/arm/lpc845_lin/lpc845_lin_defconfig
```kconfig
CONFIG_SOC_SERIES_LPC84X=y
CONFIG_SOC_LPC845=y
CONFIG_BOARD_LPC845_LIN=y

CONFIG_BUILD_OUTPUT_HEX=y

CONFIG_SYS_CLOCK_HW_CYCLES_PER_SEC=30000000

CONFIG_CONSOLE=y
CONFIG_UART_CONSOLE=y
CONFIG_SERIAL=y

CONFIG_GPIO=y
```

## boards/arm/lpc845brk/Kconfig.board
```kconfig
config BOARD_LPC845BRK
    bool "LPC845-BRK Development Board"
    depends on SOC_SERIES_LPC84X
    select SOC_PART_NUMBER_LPC845M301JBD48
```

## boards/arm/lpc845brk/Kconfig.defconfig
```kconfig
if BOARD_LPC845BRK

config BOARD
    default "LPC845-BRK"

endif # BOARD_LPC845BRK
```

## boards/arm/nogusb/Kconfig.board
```kconfig
config BOARD_NOGUSB
	bool "NOGUSB STM32G0B1KET6N Development Board"
	depends on SOC_STM32G0B1XX
```
