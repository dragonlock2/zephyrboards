## soc/arm/nxp_lpc/lpc84x/Kconfig.defconfig.series
```kconfig
if SOC_SERIES_LPC84X

rsource "Kconfig.defconfig.lpc84*"

config SOC_SERIES
    default "lpc84x"

config NUM_IRQS
    # must be >= the highest interrupt number used
    default 40

if GPIO

config GPIO_LPC84X
    default y

endif # GPIO

if SERIAL

config UART_LPC84X
    default y

endif # SERIAL

endif # SOC_SERIES_LPC84X
```

## soc/arm/nxp_lpc/lpc84x/Kconfig.series
```kconfig
config SOC_SERIES_LPC84X
    bool "LPC LPC84X Series MCU"
    select ARM
    select CPU_CORTEX_M0PLUS
    select CPU_CORTEX_M_HAS_SYSTICK
    select SOC_FAMILY_LPC

    select HAS_MCUX

    help
      Enable support for LPC LPC84X MCU series
```

## soc/arm/nxp_lpc/lpc84x/Kconfig.soc
```kconfig
choice
    prompt "LPC LPC84X MCU Selection"
    depends on SOC_SERIES_LPC84X

config SOC_LPC844
    bool "SOC_LPC844"

config SOC_LPC845
    bool "SOC_LPC845"

endchoice

if SOC_SERIES_LPC84X

config SOC_PART_NUMBER_LPC845M301JBD64
    bool
config SOC_PART_NUMBER_LPC845M301JBD48
    bool
config SOC_PART_NUMBER_LPC845M301JHI48
    bool
config SOC_PART_NUMBER_LPC845M301JHI33
    bool
config SOC_PART_NUMBER_LPC844M201JBD64
    bool
config SOC_PART_NUMBER_LPC844M201JBD48
    bool
config SOC_PART_NUMBER_LPC844M201JHI48
    bool
config SOC_PART_NUMBER_LPC844M201JHI33
    bool

config SOC_PART_NUMBER_LPC84X
    string
    default "LPC845M301JBD64" if SOC_PART_NUMBER_LPC845M301JBD64
    default "LPC845M301JBD48" if SOC_PART_NUMBER_LPC845M301JBD48
    default "LPC845M301JHI48" if SOC_PART_NUMBER_LPC845M301JHI48
    default "LPC845M301JHI33" if SOC_PART_NUMBER_LPC845M301JHI33
    default "LPC844M201JBD64" if SOC_PART_NUMBER_LPC844M201JBD64
    default "LPC844M201JBD48" if SOC_PART_NUMBER_LPC844M201JBD48
    default "LPC844M201JHI48" if SOC_PART_NUMBER_LPC844M201JHI48
    default "LPC844M201JHI33" if SOC_PART_NUMBER_LPC844M201JHI33

    help
      This string holds the full part number of the SoC. It is a hidden
      option that you should not set directly. The part number selection
      choice defines the default value for this string.

endif # SOC_SERIES_LPC84X
```

## soc/nxp/lpc/Kconfig
```kconfig
if SOC_FAMILY_LPC

rsource "*/Kconfig"

config SOC_PART_NUMBER
    default SOC_PART_NUMBER_LPC84X if SOC_SERIES_LPC84X

endif # SOC_FAMILY_LPC
```

## soc/nxp/lpc/lpc84x/Kconfig.defconfig
```kconfig
if SOC_SERIES_LPC84X

config NUM_IRQS
    # must be >= the highest interrupt number used
    default 40

endif # SOC_SERIES_LPC84X
```

## soc/nxp/lpc/lpc84x/Kconfig.soc
```kconfig
config SOC_SERIES_LPC84X
    bool
    select SOC_FAMILY_LPC

config SOC_SERIES
    default "lpc84x" if SOC_SERIES_LPC84X

config SOC_LPC844
    bool
    select SOC_SERIES_LPC84X

config SOC_LPC845
    bool
    select SOC_SERIES_LPC84X

config SOC
    default "lpc844" if SOC_LPC844
    default "lpc845" if SOC_LPC845

if SOC_SERIES_LPC84X

config SOC_PART_NUMBER_LPC845M301JBD64
    bool
config SOC_PART_NUMBER_LPC845M301JBD48
    bool
config SOC_PART_NUMBER_LPC845M301JHI48
    bool
config SOC_PART_NUMBER_LPC845M301JHI33
    bool
config SOC_PART_NUMBER_LPC844M201JBD64
    bool
config SOC_PART_NUMBER_LPC844M201JBD48
    bool
config SOC_PART_NUMBER_LPC844M201JHI48
    bool
config SOC_PART_NUMBER_LPC844M201JHI33
    bool

config SOC_PART_NUMBER_LPC84X # used to configure mcux
    string
    default "LPC845M301JBD64" if SOC_PART_NUMBER_LPC845M301JBD64
    default "LPC845M301JBD48" if SOC_PART_NUMBER_LPC845M301JBD48
    default "LPC845M301JHI48" if SOC_PART_NUMBER_LPC845M301JHI48
    default "LPC845M301JHI33" if SOC_PART_NUMBER_LPC845M301JHI33
    default "LPC844M201JBD64" if SOC_PART_NUMBER_LPC844M201JBD64
    default "LPC844M201JBD48" if SOC_PART_NUMBER_LPC844M201JBD48
    default "LPC844M201JHI48" if SOC_PART_NUMBER_LPC844M201JHI48
    default "LPC844M201JHI33" if SOC_PART_NUMBER_LPC844M201JHI33

endif # SOC_SERIES_LPC84X
```

## soc/riscv/wch_ch32/Kconfig
```kconfig
config SOC_FAMILY_WCH_CH32
	bool
	select RISCV
	select RISCV_GP
	select INCLUDE_RESET_VECTOR
	select BUILD_OUTPUT_HEX
	select TICKLESS_CAPABLE

config SOC_FAMILY
	string
	default "wch_ch32"
	depends on SOC_FAMILY_WCH_CH32

rsource "*/Kconfig.soc"
```

## soc/riscv/wch_ch32/ch32x035/Kconfig.defconfig.series
```kconfig
if SOC_SERIES_CH32X035

config SOC
    default "ch32x035"

config SOC_SERIES
    default "ch32x035"

config SYS_CLOCK_HW_CYCLES_PER_SEC
    default 48000000

config NUM_IRQS
	default 54

endif # SOC_SERIES_CH32X035
```

## soc/riscv/wch_ch32/ch32x035/Kconfig.series
```kconfig
config SOC_SERIES_CH32X035
    bool "WCH CH32X035 Series MCU"
    select SOC_FAMILY_WCH_CH32
    select RISCV_ISA_RV32I
    select RISCV_ISA_EXT_M
    select RISCV_ISA_EXT_A
    select RISCV_ISA_EXT_C
    select RISCV_ISA_EXT_ZICSR
    select ATOMIC_OPERATIONS_BUILTIN

    help
      Enable support for WCH CH32X035 MCU series
```

## soc/riscv/wch_ch32/ch32x035/Kconfig.soc
```kconfig
choice
    prompt "WCH CH32X035 MCU selection"
    depends on SOC_SERIES_CH32X035

config SOC_CH32X035
    bool "CH32X035"

endchoice
```

## west.yml
```yaml
manifest:
  remotes:
    - name: zephyrproject-rtos
      url-base: https://github.com/zephyrproject-rtos
    - name: openwch
      url-base: https://github.com/openwch

  projects:
    - name: zephyr
      remote: zephyrproject-rtos
      revision: v3.7.0
      import: true
    - name: ch32x035
      remote: openwch
      revision: ae2836e229761236ff188307636db05d71fc3cd2
      path: modules/hal/wch/ch32x035

  self:
    path: zephyrboards
```
