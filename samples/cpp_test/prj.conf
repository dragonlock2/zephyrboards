## CMakeLists.txt
```
cmake_minimum_required(VERSION 3.20.0)

find_package(Zephyr REQUIRED HINTS $ENV{ZEPHYR_BASE})
project(test)

target_sources(app PRIVATE src/main.cpp)
```

## prj.conf
```kconfig
CONFIG_CPP=y
CONFIG_GLIBCXX_LIBCPP=y
CONFIG_CPP_EXCEPTIONS=y
CONFIG_STD_CPP20=y

CONFIG_LOG=y
CONFIG_LOG_MODE_IMMEDIATE=n
CONFIG_LOG_PROCESS_TRIGGER_THRESHOLD=0
CONFIG_LOG_PROCESS_THREAD_SLEEP_MS=100

# RISC-V needs more, see zephyr/issues/55850
CONFIG_MAIN_STACK_SIZE=4096
```

## src/main.cpp
```c
#include <zephyr/kernel.h>

int main(void) {
    try {
        throw 69;
    } catch (int &e) {
        printk("caught %d\r\n", e);
    }
    return 0;
}
```
