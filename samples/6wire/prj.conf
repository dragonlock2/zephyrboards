## CMakeLists.txt
```
cmake_minimum_required(VERSION 3.20.0)

set(DTC_OVERLAY_FILE 6wire.overlay)
set(BOARD 6wire)

find_package(Zephyr REQUIRED HINTS $ENV{ZEPHYR_BASE})
project(6wire)

target_sources(app PRIVATE src/main.c)
target_sources(app PRIVATE src/fourwire.c)
```

## prj.conf
```kconfig
CONFIG_NEWLIB_LIBC=y
CONFIG_CBPRINTF_FP_SUPPORT=y

CONFIG_PWM=y

CONFIG_I2C=y

# really pushing limits here
CONFIG_HEAP_MEM_POOL_SIZE=512
CONFIG_MAIN_STACK_SIZE=1024
CONFIG_IDLE_STACK_SIZE=32
CONFIG_ISR_STACK_SIZE=512
CONFIG_SYSTEM_WORKQUEUE_STACK_SIZE=256
CONFIG_USB_WORKQUEUE_STACK_SIZE=512
CONFIG_USB_CDC_ACM_RINGBUF_SIZE=512
CONFIG_USB_DEVICE_STACK=y
```

## 6wire.overlay
```dts
/ {
    chosen {
        zephyr,console = &cdc_acm_uart0;
    };
};

&zephyr_udc0 {
    cdc_acm_uart0: cdc_acm_uart0 {
        compatible = "zephyr,cdc-acm-uart";
    };
};
```

## src/main.c
```c
#include <zephyr/kernel.h>
#include <zephyr/drivers/gpio.h>
#include <zephyr/drivers/pwm.h>
#include <zephyr/usb/usb_device.h>
#include <math.h>

#include "fourwire.h"

// devices
const struct device *leds[] = {
    DEVICE_DT_GET(DT_PWMS_CTLR(DT_ALIAS(red_pwm_led))),
    DEVICE_DT_GET(DT_PWMS_CTLR(DT_ALIAS(green_pwm_led))),
    DEVICE_DT_GET(DT_PWMS_CTLR(DT_ALIAS(blue_pwm_led))),
};

const struct gpio_dt_spec btn = GPIO_DT_SPEC_GET(DT_NODELABEL(user_btn), gpios);

const struct gpio_dt_spec mux_pins[] = {
    GPIO_DT_SPEC_GET(DT_NODELABEL(mux_a0), gpios),
    GPIO_DT_SPEC_GET(DT_NODELABEL(mux_a1), gpios),
};

const struct device *i2c = DEVICE_DT_GET(DT_NODELABEL(sercom4));

const struct gpio_dt_spec drdy = GPIO_DT_SPEC_GET(DT_NODELABEL(drdy), gpios);

// fun RGB stuffs
#define RED_NODE   DT_ALIAS(red_pwm_led)
#define GREEN_NODE DT_ALIAS(green_pwm_led)
#define BLUE_NODE  DT_ALIAS(blue_pwm_led)

#define PWM_PERIOD PWM_MSEC(10)

void set_rgb(double r, double g, double b) {
    // no invert setting :(
    pwm_set(leds[0], DT_PWMS_CHANNEL(RED_NODE),
        PWM_PERIOD, PWM_PERIOD - r * PWM_PERIOD, DT_PWMS_FLAGS(RED_NODE));
    pwm_set(leds[1], DT_PWMS_CHANNEL(GREEN_NODE),
        PWM_PERIOD, PWM_PERIOD - g * PWM_PERIOD, DT_PWMS_FLAGS(GREEN_NODE));
    pwm_set(leds[2], DT_PWMS_CHANNEL(BLUE_NODE),
        PWM_PERIOD, PWM_PERIOD - b * PWM_PERIOD, DT_PWMS_FLAGS(BLUE_NODE));
}

// app
K_THREAD_STACK_DEFINE(fourwire_stack_area, 256);

int main() {
    usb_enable(NULL);

    set_rgb(0.01, 0.01, 0.01);
    gpio_pin_configure_dt(&btn, GPIO_INPUT);

    const double REF_RES[] = {
        10.0,
        10000.0,
        10000000.0,
    };

    fourwire_config_t fourwire_cfg = {
        .ref_vals = REF_RES,
        .num_ref_vals = 3,
        .mux_pins = mux_pins,
        .num_mux_pins = 2,
        .adc_i2c = i2c,
        .adc_drdy = &drdy,
        .adc_addr = 0x40,

        .thread_stack = fourwire_stack_area,
        .thread_stack_size = K_THREAD_STACK_SIZEOF(fourwire_stack_area),
    };
    fourwire_init(&fourwire_cfg);

    while (1) {
        double val = fourwire_read(&fourwire_cfg);

        if (val < 1.0) {
            printk("%f mΩ\r\n", val * 1000.0);
        } else if (val < 1000.0) {
            printk("%f Ω\r\n", val);
        } else if (val < 1000000.0) {
            printk("%f kΩ\r\n", val / 1000.0);
        } else if (val < INFINITY) {
            printk("%f MΩ\r\n", val / 1000000.0);
        } else {
            printk("%f Ω\r\n", val);
        }
        k_msleep(100);
    }
}
```

## src/fourwire.c
```c
#include "fourwire.h"

#include <zephyr/drivers/i2c.h>
#include <math.h>
#include <stdlib.h>

void fourwire_init(fourwire_config_t *cfg) {
    // mux setup
    for (int i = 0; i < cfg->num_mux_pins; i++) {
        gpio_pin_configure_dt(&cfg->mux_pins[i], GPIO_OUTPUT_INACTIVE);
    }

    cfg->curr_ref = cfg->num_ref_vals - 1;
    fourwire_set_ref(cfg, cfg->curr_ref);

    // ADC setup
    uint8_t cmd = 0x06; // RESET
    i2c_write(cfg->adc_i2c, &cmd, 1, cfg->adc_addr);
    // input to AIN0/AIN1, gain=1, PGA enabled
    i2c_reg_write_byte(cfg->adc_i2c, cfg->adc_addr, 0x40, 0x00);
    // 20SPS, normal mode, continuous, REFP/REFN ref, no temp
    i2c_reg_write_byte(cfg->adc_i2c, cfg->adc_addr, 0x44, 0x0a);
    // no data counter, no data check, burnt-out current source off, IDAC=0A
    i2c_reg_write_byte(cfg->adc_i2c, cfg->adc_addr, 0x48, 0x00);
    // IDACs disabled
    i2c_reg_write_byte(cfg->adc_i2c, cfg->adc_addr, 0x4c, 0x00);

    cfg->curr_gain = 0; // 1x gain
    fourwire_set_gain(cfg, cfg->curr_gain);

    gpio_pin_configure_dt(cfg->adc_drdy, GPIO_INPUT);
    gpio_pin_interrupt_configure_dt(cfg->adc_drdy, GPIO_INT_EDGE_TO_ACTIVE);
    gpio_init_callback(&cfg->adc_cb, fourwire_trigger, BIT(cfg->adc_drdy->pin));
    gpio_add_callback(cfg->adc_drdy->port, &cfg->adc_cb);

    // moving average init
    cfg->num_mvg_avg  = 10;
    cfg->mvg_avg_vals = calloc(cfg->num_mvg_avg, sizeof(double));
    cfg->mvg_avg_nxt  = -1;

    // start process thread
    k_sem_init(&cfg->adc_pending, 0, 1);

    k_thread_create(&cfg->thread_data, cfg->thread_stack, cfg->thread_stack_size,
                    fourwire_process, cfg, NULL, NULL,
                    K_PRIO_PREEMPT(0), 0, K_NO_WAIT);
    k_thread_start(&cfg->thread_data);

    // start readings
    cmd = 0x08; // START/SYNC
    i2c_write(cfg->adc_i2c, &cmd, 1, cfg->adc_addr);
}

double fourwire_read(fourwire_config_t *cfg) {
    return cfg->resistance;
}

void fourwire_set_ref(fourwire_config_t *cfg, int idx) {
    for (int i = 0; i < cfg->num_mux_pins; i++) {
        gpio_pin_set_dt(&cfg->mux_pins[i], idx & (1 << i));
    }
}

void fourwire_set_gain(fourwire_config_t *cfg, int gain) {
    uint8_t old;
    i2c_reg_read_byte(cfg->adc_i2c, cfg->adc_addr, 0x20, &old);
    old = (old & 0xf1) | (gain << 1);
    i2c_reg_write_byte(cfg->adc_i2c, cfg->adc_addr, 0x40, old);
}

int32_t fourwire_read_adc(fourwire_config_t *cfg) {
    uint8_t data[3];
    i2c_burst_read(cfg->adc_i2c, cfg->adc_addr, 0x10, data, 3); // RDATA

    int32_t val = (data[0] << 16) | (data[1] << 8) | data[2];
    if (data[0] & 0x80) {
        val |= 0xff000000;
    }

    return val;
}

void fourwire_trigger(const struct device *port, 
                      struct gpio_callback *cb, gpio_port_pins_t pins) {
    fourwire_config_t *cfg = CONTAINER_OF(cb, fourwire_config_t, adc_cb);
    k_sem_give(&cfg->adc_pending);
}

void fourwire_process(void* p1, void* p2, void* p3) {
    fourwire_config_t *cfg = (fourwire_config_t*) p1;
    int32_t val;
    double res;

    while (1) {
        k_sem_take(&cfg->adc_pending, K_FOREVER);
        val = fourwire_read_adc(cfg);

        if (val == 0x7fffff) {
            res = INFINITY;
            if (cfg->curr_gain != 0) { // wrong gain?
                cfg->curr_gain = 0;
            } else if (cfg->curr_ref < cfg->num_ref_vals - 1) { // wrong ref?
                cfg->curr_ref++;
                cfg->curr_gain = 0;
            }
            cfg->mvg_avg_nxt = -1;
        } else {
            res = val * cfg->ref_vals[cfg->curr_ref] / 
                    (0x7fffff * (1 << cfg->curr_gain));

            if (cfg->curr_ref > 0 && 
                    res < 0.9 * cfg->ref_vals[cfg->curr_ref - 1]) { // better ref?
                cfg->curr_ref--;
                cfg->curr_gain = 0;
                cfg->mvg_avg_nxt = -1;
            } else { // better gain?
                uint32_t gain = (0x7fffff * (1 << cfg->curr_gain)) / val * 0.9;
                if      (gain >= 128) { cfg->curr_gain = 7; }
                else if (gain >= 64)  { cfg->curr_gain = 6; }
                else if (gain >= 32)  { cfg->curr_gain = 5; }
                else if (gain >= 16)  { cfg->curr_gain = 4; }
                else if (gain >= 8)   { cfg->curr_gain = 3; }
                else if (gain >= 4)   { cfg->curr_gain = 2; }
                else if (gain >= 2)   { cfg->curr_gain = 1; }
                else                  { cfg->curr_gain = 0; }
            }

            // moving average computations
            if (cfg->mvg_avg_nxt == -1) {
                for (int i = 0; i < cfg->num_mvg_avg; i++) {
                    cfg->mvg_avg_vals[i] = res;
                }
                cfg->mvg_avg_nxt = 0;
            } else {
                cfg->mvg_avg_vals[cfg->mvg_avg_nxt++] = res;
                cfg->mvg_avg_nxt %= cfg->num_mvg_avg;

                res = 0;
                for (int i = 0; i < cfg->num_mvg_avg; i++) {
                    res += cfg->mvg_avg_vals[i];
                }
                res /= cfg->num_mvg_avg;
            }
        }

        fourwire_set_ref(cfg, cfg->curr_ref);
        fourwire_set_gain(cfg, cfg->curr_gain);
        cfg->resistance = res;
    }
}
```

## src/fourwire.h
```c
#ifndef FOURWIRE_H
#define FOURWIRE_H

#include <zephyr.h>
#include <drivers/gpio.h>

typedef struct {
    const double *ref_vals; // ohms (MUST be in increasing order)
    const size_t num_ref_vals;

    const struct gpio_dt_spec *mux_pins;
    const size_t num_mux_pins;

    const struct device* adc_i2c;
    const struct gpio_dt_spec *adc_drdy;
    const uint8_t adc_addr;

    k_thread_stack_t *thread_stack;
    size_t thread_stack_size;

    // private vars
    int curr_ref;
    int curr_gain; // stored as log2(gain)
    double resistance;

    double *mvg_avg_vals;
    size_t num_mvg_avg;
    int mvg_avg_nxt;

    struct gpio_callback adc_cb;
    struct k_sem adc_pending;
    struct k_thread thread_data;
} fourwire_config_t;

// public functions
void fourwire_init(fourwire_config_t *cfg);
double fourwire_read(fourwire_config_t *cfg);

// "private" helpers
void fourwire_set_ref(fourwire_config_t *cfg, int idx);
void fourwire_set_gain(fourwire_config_t *cfg, int gain);
int32_t fourwire_read_adc(fourwire_config_t *cfg);
void fourwire_trigger(const struct device *port, 
                      struct gpio_callback *cb, gpio_port_pins_t pins);
void fourwire_process(void* p1, void* p2, void* p3);

#endif // FOURWIRE_H
```
