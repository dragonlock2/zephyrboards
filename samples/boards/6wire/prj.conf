## CMakeLists.txt
```
cmake_minimum_required(VERSION 3.20.0)

set(DTC_OVERLAY_FILE 6wire.overlay)
set(BOARD 6wire)

find_package(Zephyr REQUIRED HINTS $ENV{ZEPHYR_BASE})
project(6wire)

target_sources(app PRIVATE
    src/main.c
    src/fourwire.c
)
```

## prj.conf
```kconfig
CONFIG_PICOLIBC=y
CONFIG_CBPRINTF_FP_SUPPORT=y
CONFIG_PWM=y
CONFIG_I2C=y

# really pushing limits here
CONFIG_HEAP_MEM_POOL_IGNORE_MIN=y
CONFIG_HEAP_MEM_POOL_SIZE=512
CONFIG_MAIN_STACK_SIZE=1024
CONFIG_IDLE_STACK_SIZE=128
CONFIG_ISR_STACK_SIZE=512
CONFIG_SYSTEM_WORKQUEUE_STACK_SIZE=256
CONFIG_USB_WORKQUEUE_STACK_SIZE=512
CONFIG_USB_CDC_ACM_RINGBUF_SIZE=512
CONFIG_USB_DEVICE_STACK=y
```

## src/main.c
```c
#include <zephyr/kernel.h>
#include <zephyr/drivers/gpio.h>
#include <zephyr/drivers/pwm.h>
#include <zephyr/usb/usb_device.h>
#include <math.h>

#include "fourwire.h"

// devices
const struct device *leds[] = {
    DEVICE_DT_GET(DT_PWMS_CTLR(DT_ALIAS(red_pwm_led))),
    DEVICE_DT_GET(DT_PWMS_CTLR(DT_ALIAS(green_pwm_led))),
    DEVICE_DT_GET(DT_PWMS_CTLR(DT_ALIAS(blue_pwm_led))),
};

const struct gpio_dt_spec btn = GPIO_DT_SPEC_GET(DT_NODELABEL(user_btn), gpios);

const struct gpio_dt_spec mux_pins[] = {
    GPIO_DT_SPEC_GET(DT_NODELABEL(mux_a0), gpios),
    GPIO_DT_SPEC_GET(DT_NODELABEL(mux_a1), gpios),
};

const struct device *i2c = DEVICE_DT_GET(DT_NODELABEL(sercom4));

const struct gpio_dt_spec drdy = GPIO_DT_SPEC_GET(DT_NODELABEL(drdy), gpios);

// fun RGB stuffs
#define RED_NODE   DT_ALIAS(red_pwm_led)
#define GREEN_NODE DT_ALIAS(green_pwm_led)
#define BLUE_NODE  DT_ALIAS(blue_pwm_led)

#define PWM_PERIOD PWM_MSEC(10)

void set_rgb(double r, double g, double b) {
    // no invert setting :(
    pwm_set(leds[0], DT_PWMS_CHANNEL(RED_NODE),
        PWM_PERIOD, PWM_PERIOD - r * PWM_PERIOD, DT_PWMS_FLAGS(RED_NODE));
    pwm_set(leds[1], DT_PWMS_CHANNEL(GREEN_NODE),
        PWM_PERIOD, PWM_PERIOD - g * PWM_PERIOD, DT_PWMS_FLAGS(GREEN_NODE));
    pwm_set(leds[2], DT_PWMS_CHANNEL(BLUE_NODE),
        PWM_PERIOD, PWM_PERIOD - b * PWM_PERIOD, DT_PWMS_FLAGS(BLUE_NODE));
}

// app
K_THREAD_STACK_DEFINE(fourwire_stack_area, 512);

int main() {
#if CONFIG_USB_DEVICE_STACK
    usb_enable(NULL);
#endif

    set_rgb(0.01, 0.01, 0.01);
    gpio_pin_configure_dt(&btn, GPIO_INPUT);

    const double REF_RES[] = {
        10.0,
        10000.0,
        10000000.0,
    };

    fourwire_config_t fourwire_cfg = {
        .ref_vals = REF_RES,
        .num_ref_vals = 3,
        .mux_pins = mux_pins,
        .num_mux_pins = 2,
        .adc_i2c = i2c,
        .adc_drdy = &drdy,
        .adc_addr = 0x40,

        .thread_stack = fourwire_stack_area,
        .thread_stack_size = K_THREAD_STACK_SIZEOF(fourwire_stack_area),
    };
    fourwire_init(&fourwire_cfg);

    while (1) {
        double val = fourwire_read(&fourwire_cfg);

        if (val < 1.0) {
            printk("%f mΩ\r\n", val * 1000.0);
        } else if (val < 1000.0) {
            printk("%f Ω\r\n", val);
        } else if (val < 1000000.0) {
            printk("%f kΩ\r\n", val / 1000.0);
        } else if (isfinite(val)) {
            printk("%f MΩ\r\n", val / 1000000.0);
        } else {
            printk("%f Ω\r\n", val);
        }
        k_msleep(100);
    }
}
```

## src/fourwire.h
```c
#ifndef FOURWIRE_H
#define FOURWIRE_H

#include <zephyr/kernel.h>
#include <zephyr/drivers/gpio.h>

typedef struct {
    const double *ref_vals; // ohms (MUST be in increasing order)
    const size_t num_ref_vals;

    const struct gpio_dt_spec *mux_pins;
    const size_t num_mux_pins;

    const struct device* adc_i2c;
    const struct gpio_dt_spec *adc_drdy;
    const uint8_t adc_addr;

    k_thread_stack_t *thread_stack;
    size_t thread_stack_size;

    // private vars
    int curr_ref;
    int curr_gain; // stored as log2(gain)
    double resistance;

    double *mvg_avg_vals;
    size_t num_mvg_avg;
    int mvg_avg_nxt;

    struct gpio_callback adc_cb;
    struct k_sem adc_pending;
    struct k_thread thread_data;
} fourwire_config_t;

// public functions
void fourwire_init(fourwire_config_t *cfg);
double fourwire_read(fourwire_config_t *cfg);

// "private" helpers
void fourwire_set_ref(fourwire_config_t *cfg, int idx);
void fourwire_set_gain(fourwire_config_t *cfg, int gain);
int32_t fourwire_read_adc(fourwire_config_t *cfg);
void fourwire_trigger(const struct device *port, 
                      struct gpio_callback *cb, gpio_port_pins_t pins);
void fourwire_process(void* p1, void* p2, void* p3);

#endif // FOURWIRE_H
```
