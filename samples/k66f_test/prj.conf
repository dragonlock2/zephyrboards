## CMakeLists.txt
```
cmake_minimum_required(VERSION 3.20.0)

set(DTC_OVERLAY_FILE k66f.overlay)
set(BOARD k66f_breakout)

find_package(Zephyr REQUIRED HINTS $ENV{ZEPHYR_BASE})
project(k66f_test)

target_sources(app PRIVATE src/main.c)
```

## prj.conf
```kconfig
# extra peripherals
CONFIG_GPIO=y

CONFIG_ADC=y
CONFIG_SENSOR=y
CONFIG_CBPRINTF_FP_SUPPORT=y

CONFIG_COUNTER=y

CONFIG_SPI=y
CONFIG_FILE_SYSTEM=y
CONFIG_FAT_FILESYSTEM_ELM=y
CONFIG_DISK_DRIVER_SDMMC=y
CONFIG_MAIN_STACK_SIZE=2048

CONFIG_I2C=y

CONFIG_CAN=y

CONFIG_USB_DEVICE_STACK=y
CONFIG_USB_CDC_ACM=y

CONFIG_NETWORKING=y
CONFIG_NET_IPV4=y
CONFIG_NET_IPV6=n
CONFIG_NET_SOCKETS=y
CONFIG_NET_TCP=y
CONFIG_NET_UDP=y

CONFIG_NET_CONFIG_SETTINGS=y
CONFIG_NET_CONFIG_NEED_IPV4=y
CONFIG_NET_DHCPV4=y

CONFIG_NET_LOG=y
CONFIG_LOG=y
```

## src/main.c
```c
#include <zephyr.h>
#include <drivers/gpio.h>
#include <drivers/counter.h>
#include <drivers/i2c.h>
#include <drivers/can.h>
#include <drivers/uart.h>
#include <usb/usb_device.h>
#include <storage/disk_access.h>
#include <fs/fs.h>
#include <ff.h>

const struct gpio_dt_spec led[] = {
	GPIO_DT_SPEC_GET(DT_NODELABEL(led_red), gpios),
	GPIO_DT_SPEC_GET(DT_NODELABEL(led_green), gpios),
	GPIO_DT_SPEC_GET(DT_NODELABEL(led_blue), gpios)
};

const struct gpio_dt_spec btn = GPIO_DT_SPEC_GET(DT_NODELABEL(user_button), gpios);
struct gpio_callback btn_cb_data;

const struct device *counter_dev = DEVICE_DT_GET(DT_NODELABEL(rtc));

const struct gpio_dt_spec sddet = GPIO_DT_SPEC_GET(DT_NODELABEL(sd_detect), gpios);

const struct device *i2c_dev = DEVICE_DT_GET(DT_NODELABEL(i2c0));

const struct device *can_dev = DEVICE_DT_GET(DT_NODELABEL(flexcan0));

const struct device *usbcdc_dev;

const struct gpio_dt_spec usb0_id = GPIO_DT_SPEC_GET(DT_NODELABEL(usbid_0), gpios);
const struct gpio_dt_spec usb1_id = GPIO_DT_SPEC_GET(DT_NODELABEL(usbid_1), gpios);

// app
void btn_cb(const struct device *port, struct gpio_callback *cb, gpio_port_pins_t pins) {
	printk("Button pressed!\r\n");
}

int main() {
	gpio_pin_configure_dt(&led[0], GPIO_OUTPUT_INACTIVE);
	gpio_pin_configure_dt(&led[1], GPIO_OUTPUT_INACTIVE);
	gpio_pin_configure_dt(&led[2], GPIO_OUTPUT_INACTIVE);

	gpio_pin_configure_dt(&btn, GPIO_INPUT);
	gpio_pin_interrupt_configure_dt(&btn, GPIO_INT_EDGE_TO_ACTIVE);
	gpio_init_callback(&btn_cb_data, btn_cb, BIT(btn.pin));
	gpio_add_callback(btn.port, &btn_cb_data);

	counter_start(counter_dev);

	gpio_pin_configure_dt(&sddet, GPIO_INPUT);

	gpio_pin_configure_dt(&usb0_id, GPIO_INPUT);
	gpio_pin_configure_dt(&usb1_id, GPIO_INPUT);

	if (gpio_pin_get_dt(&sddet)) {
		FATFS fat_fs;
		struct fs_mount_t mp = {
			.type = FS_FATFS,
			.fs_data = &fat_fs,
			.mnt_point = "/SD:"
		};
		printk("Initializing SD: %d\r\n", disk_access_init("SD"));
		printk("Mounting FS: %d\r\n", fs_mount(&mp));
		struct fs_dir_t dirp;
		struct fs_dirent entry;
		fs_dir_t_init(&dirp);
		fs_opendir(&dirp, mp.mnt_point);
		while (1) {
			fs_readdir(&dirp, &entry);
			if (entry.name[0] == 0) {
				break;
			}
			printk("type: %d name: %s size: %d\r\n", entry.type, entry.name, entry.size);
		}
		fs_closedir(&dirp);
		printk("Unmounting FS: %d\r\n", fs_unmount(&mp));
	}

	for (uint8_t addr = 0; addr < 128; addr++) {
		if (!i2c_write(i2c_dev, NULL, 0, addr)) {
			printk("I2C device found! %d\r\n", addr);
		}
	}

	can_set_bitrate(can_dev, 1000000);
	can_set_mode(can_dev, CAN_MODE_NORMAL);

	// downclocked to 120MHz for now as workaround to get USB working
	const struct device *cdc_dev = device_get_binding("CDC_ACM_0");
	printk("Init USB: %d\r\n", usb_enable(NULL));

	int idx = 0;
	while (1) {
		gpio_pin_toggle_dt(&led[idx++]); idx %= 3;

		uint32_t ticks;
		counter_get_value(counter_dev, &ticks);

		struct zcan_frame txmsg = {
			.id      = 0x69,
			.id_type = CAN_STANDARD_IDENTIFIER,
			.rtr     = CAN_DATAFRAME,
			.dlc     = can_bytes_to_dlc(sizeof(ticks)),
		};
		memcpy(txmsg.data, &ticks, sizeof(ticks));
		can_send(can_dev, &txmsg, K_FOREVER, NULL, NULL);

		printk("Hello World! %u %d %d %d\r\n",
			ticks,
			gpio_pin_get_dt(&sddet),
			gpio_pin_get_dt(&usb0_id),
			gpio_pin_get_dt(&usb1_id));
		k_msleep(10000);
	}

	return 0;
}
```
