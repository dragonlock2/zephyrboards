## prj.conf
```kconfig
CONFIG_USB_DEVICE_STACK=y
CONFIG_USB_MASS_STORAGE=y
CONFIG_MASS_STORAGE_DISK_NAME="FAKE"

CONFIG_DISK_DRIVER_FAKE=y

# appear as SanDisk Extreme Pro
CONFIG_USB_DEVICE_VID=0x0781
CONFIG_USB_DEVICE_PID=0x5588
CONFIG_USB_DEVICE_MANUFACTURER="SanDisk"
CONFIG_USB_DEVICE_PRODUCT="Extreme Pro"
CONFIG_USB_DEVICE_SN="AA010731161120090755"
CONFIG_MASS_STORAGE_INQ_VENDOR_ID="SanDisk "
CONFIG_MASS_STORAGE_INQ_PRODUCT_ID="Extreme Pro     "
```

## src/main.c
```c
#include <zephyr/kernel.h>
#include <zephyr/usb/usb_device.h>

int main() {
    usb_enable(NULL);

    return 0;
}
```
