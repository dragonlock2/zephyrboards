## prj.conf
```kconfig
CONFIG_DEBUG_THREAD_INFO=y

CONFIG_LOG=y
CONFIG_LOG_DEFAULT_LEVEL=3
CONFIG_LOG_MODE_IMMEDIATE=y
```

## boards/jabican_usb_pro.conf
```kconfig
# NOTE insecure default key used!
CONFIG_BOOTLOADER_MCUBOOT=y
CONFIG_MCUBOOT_SIGNATURE_KEY_FILE="bootloader/mcuboot/root-rsa-2048.pem"

CONFIG_USB_DEVICE_STACK=y
CONFIG_USB_CDC_ACM=y
CONFIG_CAN=y
CONFIG_CAN_AUTO_BUS_OFF_RECOVERY=y
CONFIG_TEST_RANDOM_GENERATOR=y
CONFIG_TIMER_RANDOM_GENERATOR=y
```

## boards/k66f_breakout.conf
```kconfig
CONFIG_SPI=y
CONFIG_I2C=y
CONFIG_USB_DEVICE_STACK=y
CONFIG_USB_CDC_ACM=y
CONFIG_CAN=y
CONFIG_CAN_AUTO_BUS_OFF_RECOVERY=y
CONFIG_TEST_RANDOM_GENERATOR=y
CONFIG_TIMER_RANDOM_GENERATOR=y
CONFIG_FILE_SYSTEM=y
CONFIG_FAT_FILESYSTEM_ELM=y
CONFIG_DISK_DRIVER_SDMMC=y
CONFIG_MAIN_STACK_SIZE=2048
CONFIG_NETWORKING=y
CONFIG_NET_IPV4=y
CONFIG_NET_IPV6=n
CONFIG_NET_SOCKETS=y
CONFIG_NET_TCP=y
CONFIG_NET_UDP=y
CONFIG_NET_DHCPV4=y
```

## boards/nogusb.conf
```kconfig
CONFIG_BOOTLOADER_MCUBOOT=y
CONFIG_MCUBOOT_SIGNATURE_KEY_FILE="bootloader/mcuboot/root-rsa-2048.pem"

CONFIG_SPI=y
CONFIG_I2C=y
CONFIG_USB_DEVICE_STACK=y
CONFIG_USB_CDC_ACM=y
CONFIG_CAN=y
CONFIG_CAN_FD_MODE=y
CONFIG_CAN_AUTO_BUS_OFF_RECOVERY=y
CONFIG_TEST_RANDOM_GENERATOR=y
CONFIG_TIMER_RANDOM_GENERATOR=y
CONFIG_ADC=y
CONFIG_DAC=y
```

## boards/efm32wg.overlay
```dts
/ {
    glub {
        compatible = "test";
        leds = <&led_red &led_green &led_blue>;
        buttons = <&user_button>;
        // spi = <&usart0 &usart1>; /* TODO get working */
        i2c = <&i2c0 &i2c1>;
        uart = <&leuart0 &leuart1>;
    };
};
```

## boards/jabican_usb_pro.overlay
```dts
/ {
    flub {
        compatible = "test";
        leds = <&led_red &led_green &led_blue>;
        buttons = <&btn0 &btn1 &btn2>;
        usb;
        uart = <&uart2>;
        can = <&flexcan0>;
    };
};
```

## boards/k66f_breakout.overlay
```dts
/ {
    littlefinger {
        compatible = "test";
        leds = <&led_red &led_green &led_blue>;
        buttons = <&user_button &sd_detect &usbid_0 &usbid_1>;
        spi = <&spi0>;
        i2c = <&i2c0>;
        usb;
        sd;
        can = <&flexcan0>;
        network;
    };
};
```

## boards/k66f_usbhs.overlay
```dts
/ {
    grub {
        compatible = "test";
        leds = <&led_r &led_g &led_b>;
        buttons = <&usr_btn &sd_det>;
        usb;
        sd;
    };
};
```

## boards/lpc845brk.overlay
```dts
/ {
    flub {
        compatible = "test";
        leds = <&led_red &led_green &led_blue>;
        buttons = <&user_button>;
    };
};
```

## boards/nogusb.overlay
```dts
/ {
    fluffernutter {
        compatible = "test";
        leds = <&led_red &led_green &led_blue>;
        buttons = <&dbg_1 &dbg_2>;
        spi = <&spi2>;
        i2c = <&i2c2>;
        usb;
        adc0 {
            compatible = "test,adc";
            device = <&adc1>;
            channels = <1>;
            resolution = <12>;
            reference-voltage-mv = <36300>;
        };
        dac0 {
            compatible = "test,dac";
            device = <&dac1>;
            channels = <2>;
            resolution = <12>;
            reference-voltage-mv = <3300>;
        };
        can = <&can1>;
    };
};
```

## dts/bindings/test,adc.yaml
```yaml
description: settings for ADC channels

include: base.yaml

compatible: "test,adc"

properties:
  device:
    type: phandle
    required: true

  channels:
    type: array
    required: true

  resolution:
    type: int
    default: 12

  reference-voltage-mv:
    type: int
    default: 3300
```

## dts/bindings/test,dac.yaml
```yaml
description: settings for DAC channels

include: base.yaml

compatible: "test,dac"

properties:
  device:
    type: phandle
    required: true

  channels:
    type: array
    required: true

  resolution:
    type: int
    default: 12

  reference-voltage-mv:
    type: int
    default: 3300

  label:
    type: string
    default: "some DAC"
```

## dts/bindings/test.yaml
```yaml
description: Available peripherals to test

include: base.yaml

compatible: "test"

properties:
  leds:
    type: phandles

  buttons:
    type: phandles

  spi:
    type: phandles

  i2c:
    type: phandles

  uart:
    type: phandles

  usb:
    type: boolean

  sd:
    type: boolean

  can:
    type: phandles

  network:
    type: boolean
```

## src/main.c
```c
#include <zephyr.h>
#include <drivers/gpio.h>
#include "common.h"

const struct gpio_dt_spec led = GPIO_DT_SPEC_GET(DT_ALIAS(led0), gpios);

int main() {
#if DT_PROP(TEST_NODE, sd)
    extern int sd_test(void);
    sd_test(); // can't use SYS_INIT :(
#endif // DT_PROP(TEST_NODE, sd)

    printk("Flashing led0 in main at 1Hz so it does something...\r\n");
    gpio_pin_configure_dt(&led, GPIO_OUTPUT_INACTIVE);
    while (1) {
        gpio_pin_toggle_dt(&led);
        k_msleep(500);
    }
}
```

## src/adc_test.c
```c
#include "common.h"
#include <zephyr/drivers/adc.h>
#include <zephyr/logging/log.h>
LOG_MODULE_REGISTER(adc_test, CONFIG_LOG_DEFAULT_LEVEL);

#if DT_HAS_COMPAT_STATUS_OKAY(test_adc)

static void adc_set_test(const struct device *adc, uint8_t *channels,
        size_t num_channels, uint32_t res, uint32_t ref, char *name) {
    LOG_INF("running test on %s", name);

    uint16_t samples[1];
    struct adc_channel_cfg cfg = {
        .gain             = ADC_GAIN_1,
        .reference        = ADC_REF_INTERNAL,
        .acquisition_time = ADC_ACQ_TIME_MAX,
        .differential     = 0
    };
    struct adc_sequence seq = {
        .options      = NULL,
        .buffer       = samples,
        .buffer_size  = sizeof(samples),
        .resolution   = res,
        .oversampling = 0,
        .calibrate    = false
    };

    for (int i = 0; i < num_channels; i++) {
        cfg.channel_id = channels[i];
        adc_channel_setup(adc, &cfg);
        seq.channels = BIT(channels[i]);
        adc_read(adc, &seq);
        int32_t voltage = samples[0];
        adc_raw_to_millivolts(ref, ADC_GAIN_1, res, &voltage);
        LOG_INF("read %dmV on channel %d", voltage, channels[i]);
    }
}

#define RUN_ADC_SET(id)                                                     \
    const struct device *adc##id = DEVICE_DT_GET(DT_PROP(id, device));      \
    uint8_t chans##id[] = DT_PROP(id, channels);                            \
    size_t num_chans##id = DT_PROP_LEN(id, channels);                       \
    uint32_t res##id = DT_PROP(id, resolution);                             \
    uint32_t ref##id = DT_PROP(id, reference_voltage_mv);                   \
    adc_set_test(adc##id, chans##id, num_chans##id, res##id, ref##id, #id); \

static int adc_test(const struct device *arg) {
    LOG_INF("starting ADC test");
    DT_FOREACH_STATUS_OKAY(test_adc, RUN_ADC_SET)
    return 0;
}

SYS_INIT(adc_test, APPLICATION, 6);

#endif // DT_HAS_COMPAT_STATUS_OKAY(test_adc)
```

## src/button_test.c
```c
#include "common.h"
#include <zephyr/drivers/gpio.h>
#include <zephyr/logging/log.h>
LOG_MODULE_REGISTER(button, CONFIG_LOG_DEFAULT_LEVEL);

#if DT_NODE_HAS_PROP(TEST_NODE, buttons)

#define NUM_BTNS DT_PROP_LEN(TEST_NODE, buttons)

static const struct gpio_dt_spec btns[] = {
    DT_FOREACH_PROP_ELEM(TEST_NODE, buttons, ELEM_TO_GPIO)
};

static struct gpio_data {
    struct gpio_callback cb_data;
    int aux;
} btns_data[NUM_BTNS];

static void btn_cb(const struct device *port, struct gpio_callback *cb, gpio_port_pins_t pins) {
    struct gpio_data *data = CONTAINER_OF(cb, struct gpio_data, cb_data);
    LOG_INF("button %d pressed!", data->aux);
}

static int gpio_test(const struct device *arg) {
    LOG_INF("starting button test");
    for (int i = 0; i < NUM_BTNS; i++) {
        LOG_INF("attaching logging interrupt to button %d", i);
        btns_data[i].aux = i;
        gpio_pin_configure_dt(&btns[i], GPIO_INPUT);
        gpio_pin_interrupt_configure_dt(&btns[i], GPIO_INT_EDGE_TO_ACTIVE);
        gpio_init_callback(&btns_data[i].cb_data, btn_cb, BIT(btns[i].pin));
        gpio_add_callback(btns[i].port, &btns_data[i].cb_data);
    }
    return 0;
}

SYS_INIT(gpio_test, APPLICATION, 1);

#endif // DT_NODE_HAS_PROP(TEST_NODE, buttons)
```

## src/can_test.c
```c
#include "common.h"
#include <zephyr/random/random.h>
#include <zephyr/drivers/can.h>
#include <zephyr/logging/log.h>
LOG_MODULE_REGISTER(can_test, CONFIG_LOG_DEFAULT_LEVEL);

#if DT_NODE_HAS_PROP(TEST_NODE, can)

const struct can_filter filter = {
    .id    = 0,
    .mask  = 0,
    .flags = 0, // note extended ID ignored
    // note RTR ignored unless CONFIG_CAN_ACCEPT_RTR=y
};

static void can_test_thread(void* p1, void* p2, void* p3) {
    int idx = (int) p1;
    const struct device *can = (const struct device*) p2;
    struct k_msgq *msgq = (struct k_msgq*) p3;
    LOG_INF("thread started for CAN %d!", idx);
#ifdef CONFIG_CAN_FD_MODE
    can_set_mode(can, CAN_MODE_FD);
#else
    can_set_mode(can, CAN_MODE_NORMAL);
#endif // CONFIG_CAN_FD_MODE
    LOG_INF("dynamically setting bitrate to 1Mbps for CAN %d", idx);
    if (can_set_bitrate(can, 1000000)) {
        LOG_ERR("setting bitrate for CAN %d failed!", idx);
        return;
    }
#ifdef CONFIG_CAN_FD_MODE
    LOG_INF("dynamically setting data bitrate to 2Mbps for CAN %d", idx);
    if (can_set_bitrate_data(can, 2000000)) {
        LOG_ERR("setting data bitrate for CAN %d failed!", idx);
        return;
    }
#endif // CONFIG_CAN_FD_MODE
    can_add_rx_filter_msgq(can, msgq, &filter);
    can_start(can);

    struct can_frame txmsg = {
        .id      = 0x69,
        .dlc     = 0, // set later
#ifdef CONFIG_CAN_FD_MODE
        .flags   = CAN_FRAME_FDF | CAN_FRAME_BRS,
#else
        .flags   = 0,
#endif // CONFIG_CAN_FD_MODE
    };

    while (1) {
        uint32_t rand = sys_rand32_get();
        memcpy(txmsg.data, &rand, sizeof(rand));
        txmsg.dlc = can_bytes_to_dlc(sizeof(rand));
        can_send(can, &txmsg, K_FOREVER, NULL, NULL);
        LOG_INF("sent 0x%x on CAN %d", rand, idx);

        struct can_frame rxmsg;
        k_msgq_get(msgq, &rxmsg, K_FOREVER);
        memcpy(&rand, rxmsg.data, sizeof(rand));
        LOG_INF("recvd 0x%x from id 0x%x w/ dlc %d on CAN %d",
                rand, rxmsg.id, rxmsg.dlc, idx);

        k_msleep(1000);
    }
}

#define CREATE_CAN_TEST(node_id, prop, idx)                                           \
    CAN_MSGQ_DEFINE(msgq##idx, 32);                                                   \
    K_THREAD_STACK_DEFINE(can##idx_stack, 1024);                                      \
    struct k_thread can##idx_thread_data;                                             \
                                                                                      \
    static void can_test##idx() {                                                     \
        const struct device *can = DEVICE_DT_GET(DT_PROP_BY_IDX(node_id, prop, idx)); \
        LOG_INF("setting up ping pong thread for CAN %d", idx);                       \
        size_t stack_size = K_THREAD_STACK_SIZEOF(can##idx_stack);                    \
        k_thread_create(&can##idx_thread_data, can##idx_stack, stack_size,            \
                        can_test_thread, idx, (void*) can, &msgq##idx,                \
                        K_PRIO_PREEMPT(0), 0, K_NO_WAIT);                             \
        k_thread_start(&can##idx_thread_data);                                        \
    }
DT_FOREACH_PROP_ELEM(TEST_NODE, can, CREATE_CAN_TEST)

#define RUN_CAN_TEST(node_id, prop, idx) can_test##idx();
static int can_test(void) {
    LOG_INF("starting CAN test");
    DT_FOREACH_PROP_ELEM(TEST_NODE, can, RUN_CAN_TEST)
    return 0;
}

SYS_INIT(can_test, APPLICATION, 8);

#endif // DT_NODE_HAS_PROP(TEST_NODE, can)
```

## src/common.h
```c
#ifndef COMMON_H
#define COMMON_H

#include <zephyr/device.h>
#include <zephyr/init.h>

#define TEST_NODE DT_COMPAT_GET_ANY_STATUS_OKAY(test)

#define ELEM_TO_GPIO(node_id, prop, idx) \
    GPIO_DT_SPEC_GET(DT_PROP_BY_IDX(node_id, prop, idx), gpios),

#define ELEM_TO_DEVICE(node_id, prop, idx) \
    DEVICE_DT_GET(DT_PROP_BY_IDX(node_id, prop, idx)),

#endif // COMMON_H
```

## src/dac_test.c
```c
#include "common.h"
#include <zephyr/drivers/dac.h>
#include <zephyr/logging/log.h>
LOG_MODULE_REGISTER(dac_test, CONFIG_LOG_DEFAULT_LEVEL);

#if DT_HAS_COMPAT_STATUS_OKAY(test_dac)

static void dac_set_test(const struct device *dac, uint8_t *channels,
        size_t num_channels, uint32_t res, uint32_t ref, char *name) {
    LOG_INF("running test on %s", name);

    struct dac_channel_cfg cfg = {
        .resolution = res
    };

    for (int i = 0; i < num_channels; i++) {
        cfg.channel_id = channels[i];
        dac_channel_setup(dac, &cfg);
        dac_write_value(dac, channels[i], (1 << res) * 1000 / ref);
        LOG_INF("set channel %d to 1V", channels[i]);
    }
}

#define RUN_DAC_SET(id)                                                     \
    const struct device *dac##id = DEVICE_DT_GET(DT_PROP(id, device));      \
    uint8_t chans##id[] = DT_PROP(id, channels);                            \
    size_t num_chans##id = DT_PROP_LEN(id, channels);                       \
    uint32_t res##id = DT_PROP(id, resolution);                             \
    uint32_t ref##id = DT_PROP(id, reference_voltage_mv);                   \
    dac_set_test(dac##id, chans##id, num_chans##id, res##id, ref##id, #id); \

static int dac_test(void) {
    LOG_INF("starting DAC test");
    DT_FOREACH_STATUS_OKAY(test_dac, RUN_DAC_SET)
    return 0;
}

SYS_INIT(dac_test, APPLICATION, 7);

#endif // DT_HAS_COMPAT_STATUS_OKAY(test_dac)
```

## src/i2c_test.c
```c
#include "common.h"
#include <zephyr/drivers/i2c.h>
#include <zephyr/logging/log.h>
LOG_MODULE_REGISTER(i2c_test, CONFIG_LOG_DEFAULT_LEVEL);

#if DT_NODE_HAS_PROP(TEST_NODE, i2c)

#define NUM_I2C DT_PROP_LEN(TEST_NODE, i2c)

static const struct device *i2cs[] = {
    DT_FOREACH_PROP_ELEM(TEST_NODE, i2c, ELEM_TO_DEVICE)
};

static int i2c_test(void) {
    LOG_INF("starting I2C test");
    for (int i = 0; i < NUM_I2C; i++) {
        LOG_INF("scanning for devices on I2C %d", i);
        for (uint8_t addr = 0; addr < 128; addr++) {
            if (!i2c_write(i2cs[i], NULL, 0, addr)) {
                LOG_INF("device 0x%x found!", addr);
            }
        }
    }
    return 0;
}

SYS_INIT(i2c_test, APPLICATION, 3);

#endif // DT_NODE_HAS_PROP(TEST_NODE, i2c)
```

## src/led_test.c
```c
#include "common.h"
#include <zephyr/kernel.h>
#include <zephyr/drivers/gpio.h>
#include <zephyr/logging/log.h>
LOG_MODULE_REGISTER(led, CONFIG_LOG_DEFAULT_LEVEL);

#if DT_NODE_HAS_PROP(TEST_NODE, leds)

#define NUM_LEDS DT_PROP_LEN(TEST_NODE, leds)

static const struct gpio_dt_spec leds[] = {
    DT_FOREACH_PROP_ELEM(TEST_NODE, leds, ELEM_TO_GPIO)
};

static int gpio_test(void) {
    LOG_INF("starting LED test");
    for (int i = 0; i < NUM_LEDS; i++) {
        LOG_INF("flashing LED %d", i);
        gpio_pin_configure_dt(&leds[i], GPIO_OUTPUT_INACTIVE);
        for (int j = 0; j < 6; j++) {
            gpio_pin_toggle_dt(&leds[i]);
            k_msleep(69);
        }
    }
    return 0;
}

SYS_INIT(gpio_test, APPLICATION, 0);

#endif // DT_HAS_PROP(TEST_NODE, leds)
```

## src/network_test.c
```c
#include "common.h"
#include <zephyr/net/net_if.h>
#include <zephyr/net/net_core.h>
#include <zephyr/net/net_context.h>
#include <zephyr/net/net_mgmt.h>
#include <zephyr/logging/log.h>
LOG_MODULE_REGISTER(network_test, CONFIG_LOG_DEFAULT_LEVEL);

#if DT_PROP(TEST_NODE, network)

static struct k_sem lock;
static struct net_mgmt_event_callback mgmt_cb;

static void handler(struct net_mgmt_event_callback *cb, uint32_t mgmt_event,
                    struct net_if *iface) {
    if (mgmt_event != NET_EVENT_IPV4_ADDR_ADD) {
        return;
    }

    for (int i = 0; i < NET_IF_MAX_IPV4_ADDR; i++) {
        char buf[NET_IPV4_ADDR_LEN];
        if (iface->config.ip.ipv4->unicast[i].addr_type != NET_ADDR_DHCP) {
            continue;
        }
        LOG_INF("Got address: %s", 
            net_addr_ntop(AF_INET, &iface->config.ip.ipv4->unicast[i].address.in_addr,
                buf, sizeof(buf)));
    }

    k_sem_give(&lock);
}

static int network_test(void) {
    k_sem_init(&lock, 0, 1);

    LOG_INF("Waiting for an IPV4 address...");
    net_mgmt_init_event_callback(&mgmt_cb, handler, NET_EVENT_IPV4_ADDR_ADD);
    net_mgmt_add_event_callback(&mgmt_cb);
    net_dhcpv4_start(net_if_get_default());

    k_sem_take(&lock, K_FOREVER);

    return 0;
}

SYS_INIT(network_test, APPLICATION, 9);

#endif // DT_PROP(TEST_NODE, usb)
```

## src/sd_test.c
```c
#include "common.h"
#include <logging/log.h>
LOG_MODULE_REGISTER(sd_test, CONFIG_LOG_DEFAULT_LEVEL);

#if DT_PROP(TEST_NODE, sd)

#include <storage/disk_access.h>
#include <fs/fs.h>
#include <ff.h>

int sd_test(void) {
    int rc;
    FATFS fat_fs;
    struct fs_mount_t mp = {
        .type = FS_FATFS,
        .fs_data = &fat_fs,
        .mnt_point = "/SD:"
    };

    LOG_INF("initializing SD card");
    rc = disk_access_init("SD");
    if (rc) {
        LOG_ERR("SD initialization failed! %d", rc);
        return rc;
    }

    LOG_INF("mounting FS");
    rc = fs_mount(&mp);
    if (rc) {
        LOG_ERR("FS mounting failed! %d", rc);
        return rc;
    }

    LOG_INF("listing files in root directory");
    struct fs_dir_t dirp;
    struct fs_dirent entry;
    fs_dir_t_init(&dirp);
    fs_opendir(&dirp, mp.mnt_point);
    while (1) {
        fs_readdir(&dirp, &entry);
        if (entry.name[0] == 0) {
            break;
        }
        LOG_INF("type: %d name: %s size: %d", entry.type, entry.name, entry.size);
    }
    fs_closedir(&dirp);
    LOG_INF("unmounting FS");
    rc = fs_unmount(&mp);
    if (rc) {
        LOG_ERR("FS unmounting failed! %d", rc);
        return rc;
    }

    return 0;
}

#endif // DT_PROP(TEST_NODE, sd)
```

## src/spi_test.c
```c
#include "common.h"
#include <zephyr/drivers/spi.h>
#include <zephyr/logging/log.h>
LOG_MODULE_REGISTER(spi_test, CONFIG_LOG_DEFAULT_LEVEL);

#if DT_NODE_HAS_PROP(TEST_NODE, spi)

#define NUM_SPI DT_PROP_LEN(TEST_NODE, spi)

static const struct device *spis[] = {
    DT_FOREACH_PROP_ELEM(TEST_NODE, spi, ELEM_TO_DEVICE)
};

static int spi_test(const struct device *arg) {
    LOG_INF("starting SPI test");

    struct spi_config cfg = {0};
    cfg.frequency = 250000;
    cfg.operation |= SPI_OP_MODE_MASTER;
    // cfg.operation |= SPI_MODE_CPOL;
    // cfg.operation |= SPI_MODE_CPHA;
    // cfg.operation |= SPI_MODE_LOOP;
    cfg.operation |= SPI_TRANSFER_LSB;
    cfg.operation |= SPI_WORD_SET(8); // bits/word
    cfg.operation |= SPI_LINES_SINGLE;
    // cfg.operation |= SPI_HOLD_ON_CS;
    // cfg.operation |= SPI_LOCK_ON;
    // cfg.operation |= SPI_CS_ACTIVE_HIGH;

    uint8_t tx[4] = {1,2,3,4};
    struct spi_buf tx_buf = { .buf = tx, .len = sizeof(tx) };
    struct spi_buf_set tx_buf_set = { .buffers = &tx_buf, .count = 1 };

    uint8_t rx[4] = {0};
    struct spi_buf rx_buf = { .buf = rx, .len = sizeof(rx) };
    struct spi_buf_set rx_buf_set = { .buffers = &rx_buf, .count = 1 };

    for (int i = 0; i < NUM_SPI; i++) {
        LOG_INF("transceiving some bytes on SPI %d", i);
        spi_transceive(spis[i], &cfg, &tx_buf_set, &rx_buf_set);
        for (int j = 0; j < sizeof(tx); j++) {
            LOG_INF("sent: 0x%x\trecvd: 0x%x", tx[j], rx[j]);
        }
    }
    return 0;
}

SYS_INIT(spi_test, APPLICATION, 2);

#endif // DT_NODE_HAS_PROP(TEST_NODE, spi)
```

## src/uart_test.c
```c
#include "common.h"
#include <zephyr/kernel.h>
#include <zephyr/drivers/uart.h>
#include <zephyr/logging/log.h>
LOG_MODULE_REGISTER(uart_test, CONFIG_LOG_DEFAULT_LEVEL);

#if DT_NODE_HAS_PROP(TEST_NODE, uart)

#define NUM_UART DT_PROP_LEN(TEST_NODE, uart)

static const struct device *uarts[] = {
    DT_FOREACH_PROP_ELEM(TEST_NODE, uart, ELEM_TO_DEVICE)
};

static int uart_test(void) {
    LOG_INF("starting UART test");
    char c = 'a', d;
    for (int i = 0; i < NUM_UART; i++) {
        LOG_INF("sent '%c' on UART %d", c, i);
        uart_poll_out(uarts[i], c);
        k_msleep(10);
        if (uart_poll_in(uarts[i], &d) < 0) {
            LOG_ERR("didn't receive char in time :(");
        } else {
            LOG_INF("received '%c'", d);
        }
        c++;
    }
    return 0;
}

SYS_INIT(uart_test, APPLICATION, 4);

#endif // DT_NODE_HAS_PROP(TEST_NODE, uart)
```

## src/usb_test.c
```c
#include "common.h"
#include <zephyr/usb/usb_device.h>
#include <zephyr/logging/log.h>
LOG_MODULE_REGISTER(usb_test, CONFIG_LOG_DEFAULT_LEVEL);

#if DT_PROP(TEST_NODE, usb)

static int usb_test(const struct device *arg) {
    LOG_INF("enabling USB, returned %d, plug in to check", usb_enable(NULL));
    return 0;
}

SYS_INIT(usb_test, APPLICATION, 5);

#endif // DT_PROP(TEST_NODE, usb)
```
