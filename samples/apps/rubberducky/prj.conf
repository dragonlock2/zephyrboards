## CMakeLists.txt
```
cmake_minimum_required(VERSION 3.20.0)

include_directories(src) # override header :)

find_package(Zephyr REQUIRED HINTS $ENV{ZEPHYR_BASE})
project(rubberducky)

target_include_directories(app PRIVATE
    inc
)

target_sources(app PRIVATE
    src/main.cpp
    src/error.cpp
    src/hid.cpp
    src/payload.cpp
    src/rgb.cpp
)

function(add_payload PAYLOAD_NAME)
    add_llext_target(${PAYLOAD_NAME}
        OUTPUT ${ZEPHYR_BINARY_DIR}/payloads/${PAYLOAD_NAME}.elf
        SOURCES payloads/${PAYLOAD_NAME}.cpp
    )
    llext_include_directories(${PAYLOAD_NAME} inc)
    add_dependencies(app ${PAYLOAD_NAME}) # TODO try EDK
endfunction()

add_payload(example)
add_payload(shell)
```

## prj.conf
```kconfig
CONFIG_CPP=y
CONFIG_STD_CPP20=y
CONFIG_MAIN_STACK_SIZE=4096

CONFIG_LOG=y
CONFIG_USB_DRIVER_LOG_LEVEL_WRN=y
CONFIG_USB_DEVICE_LOG_LEVEL_WRN=y
CONFIG_USB_HID_LOG_LEVEL_WRN=y
CONFIG_LLEXT_LOG_LEVEL_WRN=y
CONFIG_LOG_MODE_IMMEDIATE=n
CONFIG_LOG_PROCESS_TRIGGER_THRESHOLD=0
CONFIG_LOG_PROCESS_THREAD_SLEEP_MS=100

CONFIG_USB_DEVICE_STACK=y
CONFIG_USB_DEVICE_VID=0x05ac
CONFIG_USB_DEVICE_PID=0x021e
CONFIG_USB_DEVICE_MANUFACTURER="dragonlock2"
CONFIG_USB_DEVICE_PRODUCT="rubberducky"
CONFIG_USB_SELF_POWERED=n
CONFIG_USB_DEVICE_HID=y
CONFIG_USB_HID_DEVICE_COUNT=2
CONFIG_USB_HID_POLL_INTERVAL_MS=1
CONFIG_USB_HID_BOOT_PROTOCOL=y

CONFIG_FILE_SYSTEM=y
CONFIG_FAT_FILESYSTEM_ELM=y
CONFIG_DISK_DRIVER_SDMMC=y

CONFIG_LLEXT=y
CONFIG_LLEXT_HEAP_SIZE=64
CONFIG_LLEXT_STORAGE_WRITABLE=n
```

## src/main.cpp
```c
#include <zephyr/kernel.h>
#include <zephyr/logging/log.h>
#include <zephyr/usb/class/usb_hid.h>
#include "error.h"
#include "hid.h"
#include "payload.h"
#include "rgb.h"

LOG_MODULE_REGISTER(main, CONFIG_LOG_DEFAULT_LEVEL);

int main(void) {
    rgb_init();
    payload_init();
    hid_init();

    payload_run();
    hid_keyboard_report k{};
    hid_mouse_report m{};
    hid_keyboard_raw(k);
    hid_mouse_raw(m);
    while (true) {
        rgb_write(rgb_color::GREEN);
        k_msleep(50);
        rgb_write(rgb_color::OFF);
        k_msleep(50);
    }
}
```

## inc/error.h
```c
#pragma once

enum class error_reason {
    HID,
    PAYLOAD,
};

void error_fatal(error_reason code);
```

## inc/hid.h
```c
#pragma once

extern "C" {

enum hid_os {
    UNKNOWN,
    MACOS,
    WINDOWS,
    LINUX,
};

enum hid_mouse_button {
    NONE = 0x00,
    LEFT = 0x01,
    RIGHT = 0x02,
    MIDDLE = 0x04,
};

struct hid_keyboard_report { // see usb/class/hid.h
    uint8_t modifier;
    uint8_t reserved;
    uint8_t keycode[6];
};

struct hid_mouse_report {
    uint8_t buttons;
    int8_t x;
    int8_t y;
    int8_t scroll;
};

void hid_init(void);
hid_os hid_get_os(void);
void hid_keyboard_raw(const hid_keyboard_report &report);
void hid_mouse_raw(const hid_mouse_report &report);

}
```

## inc/payload.h
```c
#pragma once

void payload_init(void);
void payload_run(void);
```

## inc/rgb.h
```c
#pragma once

extern "C" {

enum class rgb_color {
    OFF,
    RED,
    GREEN,
    BLUE,
    CYAN,
    MAGENTA,
    YELLOW,
    WHITE,
};

void rgb_init(void);
void rgb_write(rgb_color c);

}
```

## src/bos_desc.h
```c
#ifndef ZEPHYR_INCLUDE_USB_DEVICE_BOS_DESC_H_
#define ZEPHYR_INCLUDE_USB_DEVICE_BOS_DESC_H_

#include <stdint.h>
#include <zephyr/usb/usb_ch9.h>

#ifdef CONFIG_USB_DEVICE_BOS
#error "os detection workaround not compatible with CONFIG_USB_DEVICE_BOS"
#endif

int usb_handle_bos(struct usb_setup_packet *setup, int32_t *len, uint8_t **data);

#endif	/* ZEPHYR_INCLUDE_USB_DEVICE_BOS_DESC_H_ */
```

## src/error.cpp
```c
#include <zephyr/kernel.h>
#include <rgb.h>
#include "error.h"

void error_fatal(error_reason code) {
    switch (code) {
        case error_reason::HID:
            for (int i = 0; i < 2; i++) {
                rgb_write(rgb_color::RED);
                k_msleep(50);
                rgb_write(rgb_color::OFF);
                k_msleep(200);
            }
            break;

        case error_reason::PAYLOAD:
            for (int i = 0; i < 3; i++) {
                rgb_write(rgb_color::RED);
                k_msleep(50);
                rgb_write(rgb_color::OFF);
                k_msleep(200);
            }
            break;
    }
    while (1) { k_msleep(1); }
}
```

## src/hid.cpp
```c
#include <zephyr/kernel.h>
#include <zephyr/logging/log.h>
#include <zephyr/usb/usb_device.h>
#include <zephyr/usb/class/usb_hid.h>
#include <error.h>
#include <hid.h>

LOG_MODULE_REGISTER(hid, CONFIG_LOG_DEFAULT_LEVEL);

#pragma GCC diagnostic push
#pragma GCC diagnostic ignored "-Wnarrowing"
static const uint8_t keyboard_report_desc[] = HID_KEYBOARD_REPORT_DESC();
static const uint8_t mouse_report_desc[] = HID_MOUSE_REPORT_DESC(3);
#pragma GCC diagnostic pop

static struct {
    const struct device *keyboard_dev, *mouse_dev;
    struct k_sem keyboard_lock, mouse_lock;
    struct k_sem usb_conn;
    uint8_t cnt_wl, cnt_02, cnt_04, cnt_ff;
    hid_os os;
} data;

extern "C" int usb_handle_bos(struct usb_setup_packet *setup, int32_t*, uint8_t**) {
    if (usb_reqtype_is_to_host(setup) && USB_GET_DESCRIPTOR_TYPE(setup->wValue) == USB_DESC_STRING) {
        data.cnt_wl++;
        switch (setup->wLength) {
            case 0x02: data.cnt_02++; break;
            case 0x04: data.cnt_04++; break;
            case 0xff: data.cnt_ff++; break;
        };
    }
    return -ENOTSUP;
}

static void hid_usb_cb(enum usb_dc_status_code cb_status, const uint8_t *param) {
    if (cb_status == USB_DC_CONFIGURED) {
        k_sem_give(&data.usb_conn);
    }
}

static void hid_keyboard_cb(const struct device *dev) {
    k_sem_give(&data.keyboard_lock);
}

static void hid_mouse_cb(const struct device *dev) {
    k_sem_give(&data.mouse_lock);
}

void hid_init(void) {
    data.os = hid_os::UNKNOWN;
    k_sem_init(&data.usb_conn, 0, 1);
    k_sem_init(&data.keyboard_lock, 1, 1);
    k_sem_init(&data.mouse_lock, 1, 1);

    data.keyboard_dev = device_get_binding("HID_0");
    data.mouse_dev = device_get_binding("HID_1");
    if (data.keyboard_dev == NULL || data.mouse_dev == NULL) {
        LOG_ERR("failed get hid device");
        error_fatal(error_reason::HID);
    }

    static const struct hid_ops keyboard_ops = { .int_in_ready = hid_keyboard_cb, };
    static const struct hid_ops mouse_ops = { .int_in_ready = hid_mouse_cb, };
    usb_hid_register_device(data.keyboard_dev, keyboard_report_desc, sizeof(keyboard_report_desc), &keyboard_ops);
    usb_hid_register_device(data.mouse_dev, mouse_report_desc, sizeof(mouse_report_desc), &mouse_ops);

    if (usb_hid_init(data.keyboard_dev) != 0 || usb_hid_init(data.mouse_dev) != 0) {
        LOG_ERR("failed init hid");
        error_fatal(error_reason::HID);
    }
    if (usb_enable(hid_usb_cb) != 0) {
        LOG_ERR("failed enable usb");
        error_fatal(error_reason::HID);
    }
    k_sem_take(&data.usb_conn, K_FOREVER);
    k_msleep(500); // reports ignored if too soon

    // algorithm inspired by https://github.com/qmk/qmk_firmware/blob/master/quantum/os_detection.c
    // due to OS updates, this may not work forever
    if (data.cnt_wl == data.cnt_ff) {
        data.os = hid_os::LINUX;
    } else if (data.cnt_ff >= 2 && data.cnt_04 >= 1) {
        data.os = hid_os::WINDOWS;
    } else if (data.cnt_04 == 0 && data.cnt_02 >= 1) {
        data.os = hid_os::MACOS;
    } else {
        LOG_WRN("unknown os: %d %d %d %d", data.cnt_02, data.cnt_04, data.cnt_ff, data.cnt_wl);
        data.os = hid_os::UNKNOWN;
    }

    LOG_INF("usb connected %d", data.os);
}

hid_os hid_get_os(void) {
    return data.os;
}

void hid_keyboard_raw(const hid_keyboard_report &report) {
    k_sem_take(&data.keyboard_lock, K_FOREVER);
    if (hid_int_ep_write(data.keyboard_dev, reinterpret_cast<const uint8_t*>(&report), sizeof(hid_keyboard_report), NULL) != 0) {
        LOG_ERR("failed keyboard write");
        error_fatal(error_reason::HID);
    }
}

void hid_mouse_raw(const hid_mouse_report &report) {
    k_sem_take(&data.mouse_lock, K_FOREVER);
    if (hid_int_ep_write(data.mouse_dev, reinterpret_cast<const uint8_t*>(&report), sizeof(hid_mouse_report), NULL) != 0) {
        LOG_ERR("failed mouse write");
        error_fatal(error_reason::HID);
    }
}
```

## src/payload.cpp
```c
#include <zephyr/kernel.h>
#include <zephyr/logging/log.h>
#include <zephyr/llext/llext.h>
#include <zephyr/llext/loader.h>
#include <zephyr/llext/symbol.h>
#include <zephyr/storage/disk_access.h>
#include <zephyr/fs/fs.h>
#include <ff.h>
#include "error.h"
#include "hid.h"
#include "rgb.h"
#include "payload.h"

LOG_MODULE_REGISTER(payload, CONFIG_LOG_DEFAULT_LEVEL);

#define DRIVE_NAME "SD"
#define MOUNT_PT   "/SD:"
#define ROOT_DIR   "/SD:/"

struct llext_file_loader {
    struct fs_file_t payload;
    struct llext_loader loader;
};

static struct {
    FATFS fat_fs;
    struct fs_mount_t mp;
    struct llext_file_loader loader;
    struct llext *payload;
    void (*run)(void);
} data;

static int llext_file_read(struct llext_loader *ldr, void *out, size_t len) {
    struct llext_file_loader *lf = CONTAINER_OF(ldr, struct llext_file_loader, loader);
    return fs_read(&lf->payload, out, len) == (ssize_t) len ? 0 : -1;
}

static int llext_file_seek(struct llext_loader *ldr, size_t pos) {
    struct llext_file_loader *lf = CONTAINER_OF(ldr, struct llext_file_loader, loader);
    return fs_seek(&lf->payload, pos, FS_SEEK_SET);
}

void payload_init(void) {
    // mount filesystem
    if (disk_access_init(DRIVE_NAME) != 0) {
        LOG_ERR("failed init drive");
        error_fatal(error_reason::PAYLOAD);
    }

    data.mp.type = FS_FATFS;
    data.mp.fs_data = &data.fat_fs;
    data.mp.mnt_point = MOUNT_PT;
    if (fs_mount(&data.mp) != 0) {
        LOG_ERR("failed fatfs mount");
        error_fatal(error_reason::PAYLOAD);
    }

    // get payload name
    struct fs_file_t cfg;
    fs_file_t_init(&cfg);
    if (fs_open(&cfg, ROOT_DIR "config.txt", FS_O_READ) != 0) {
        LOG_ERR("failed open config.txt");
        error_fatal(error_reason::PAYLOAD);
    }

    char payload_name[strlen(ROOT_DIR) + 128] = ROOT_DIR;
    ssize_t end = fs_read(&cfg, &payload_name[strlen(ROOT_DIR)], 128);
    if (end < 0) {
        LOG_ERR("failed read config.txt");
        error_fatal(error_reason::PAYLOAD);
    }
    if (end == 128) {
        LOG_ERR("payload filename too long");
        error_fatal(error_reason::PAYLOAD);
    }
    payload_name[strlen(ROOT_DIR) + end] = '\0';
    LOG_INF("using \"%s\"", &payload_name[strlen(ROOT_DIR)]);

    if (fs_close(&cfg) != 0) {
        LOG_ERR("failed close config.txt");
        error_fatal(error_reason::PAYLOAD);
    }

    // load payload
    fs_file_t_init(&data.loader.payload);
    if (fs_open(&data.loader.payload, payload_name, FS_O_READ) != 0) {
        LOG_ERR("failed open payload");
        error_fatal(error_reason::PAYLOAD);
    }

    data.loader.loader.read = llext_file_read;
    data.loader.loader.seek = llext_file_seek;
    data.loader.loader.peek = NULL;
    struct llext_load_param loader_param = LLEXT_LOAD_PARAM_DEFAULT;
    if (llext_load(&data.loader.loader, "payload", &data.payload, &loader_param) == 0) {
        data.run = reinterpret_cast<void (*)(void)>(llext_find_sym(&data.payload->exp_tab, "run"));
    } else {
        LOG_ERR("failed load payload");
    }

    if (fs_close(&data.loader.payload) != 0) {
        LOG_ERR("failed close payload");
        error_fatal(error_reason::PAYLOAD);
    }

    // unmount filesystem
    if (fs_unmount(&data.mp) != 0) {
        LOG_ERR("failed fatfs unmount");
        error_fatal(error_reason::PAYLOAD);
    }
}

void payload_run(void) {
    if (data.run) {
        LOG_INF("start");
        data.run();
        LOG_INF("done");
    } else {
        LOG_ERR("no payload run()");
        error_fatal(error_reason::PAYLOAD);
    }
}

EXPORT_SYMBOL(hid_get_os);
EXPORT_SYMBOL(hid_keyboard_raw);
EXPORT_SYMBOL(hid_mouse_raw);
EXPORT_SYMBOL(rgb_write);
```

## src/rgb.cpp
```c
#include <zephyr/kernel.h>
#include <zephyr/drivers/gpio.h>
#include "rgb.h"

static const struct gpio_dt_spec leds[3] = {
    GPIO_DT_SPEC_GET(DT_ALIAS(led0), gpios),
    GPIO_DT_SPEC_GET(DT_ALIAS(led1), gpios),
    GPIO_DT_SPEC_GET(DT_ALIAS(led2), gpios),
};

static void rgb_write_raw(uint8_t r, uint8_t g, uint8_t b) {
    // TODO PWM support
    gpio_pin_set_dt(&leds[0], r);
    gpio_pin_set_dt(&leds[1], g);
    gpio_pin_set_dt(&leds[2], b);
}

void rgb_init(void) {
    gpio_pin_configure_dt(&leds[0], GPIO_OUTPUT_INACTIVE);
    gpio_pin_configure_dt(&leds[1], GPIO_OUTPUT_INACTIVE);
    gpio_pin_configure_dt(&leds[2], GPIO_OUTPUT_INACTIVE);
}

void rgb_write(rgb_color c) {
    switch (c) {
        default:
        case rgb_color::OFF:     rgb_write_raw(0,   0,   0);   break;
        case rgb_color::RED:     rgb_write_raw(255, 0,   0);   break;
        case rgb_color::GREEN:   rgb_write_raw(0,   255, 0);   break;
        case rgb_color::BLUE:    rgb_write_raw(0,   0,   255); break;
        case rgb_color::CYAN:    rgb_write_raw(0,   255, 255); break;
        case rgb_color::MAGENTA: rgb_write_raw(255, 0,   255); break;
        case rgb_color::YELLOW:  rgb_write_raw(255, 255, 0);   break;
        case rgb_color::WHITE:   rgb_write_raw(255, 255, 255); break;
    }
}
```
