## drivers/serial/Kconfig.ch32
```kconfig
menuconfig UART_CH32
    bool "CH32 UART driver"
    default y if SOC_FAMILY_WCH_CH32
    select SERIAL_HAS_DRIVER
    select SERIAL_SUPPORT_INTERRUPT
```

## drivers/serial/Kconfig.lpc84x
```kconfig
menuconfig UART_LPC84X
    bool "LPC84X UART driver"
    default y
    depends on DT_HAS_NXP_LPC84X_UART_ENABLED
    select SERIAL_HAS_DRIVER
    select SERIAL_SUPPORT_INTERRUPT
```

## drivers/swm/Kconfig
```kconfig
menuconfig SWM
  bool "Switch matrix support"
  help
    Enable support for switch matrix

if SWM

config SWM_INIT_PRIORITY
  int "SWM init priority"
  default KERNEL_INIT_PRIORITY_OBJECTS
  help
    SWM driver device initialization priority.

module = SWM
module-str = switch matrix
source "subsys/logging/Kconfig.template.log_config"

rsource "Kconfig.lpc84x"

endif # SWM
```

## drivers/swm/Kconfig.lpc84x
```kconfig
menuconfig SWM_LPC84X
    bool "LPC84X SWM"
    depends on SOC_SERIES_LPC84X
    help
      Enable driver for SWM used in
      LPC84X MCUs

if SWM_LPC84X

endif # SWM_LPC84X
```

## drivers/usb/device/Kconfig
```kconfig
if USB_DEVICE_DRIVER

menuconfig USB_DC_CH32_USBFS
    bool "USB device controller driver for WCH CH32 USBFS devices"
    default y
    depends on DT_HAS_WCH_CH32_USBFS_ENABLED

endif
```

## drivers/usb_c/tcpc/Kconfig.ch32
```kconfig
menuconfig USBC_TCPC_CH32
    bool "USB-C TCPC device controller driver"
    default y
    depends on DT_HAS_WCH_CH32_UCPD_ENABLED
```

## dts/bindings/clock/nxp,lpc84x-syscon.yaml
```yaml
description: LPC84X SYSCON node

compatible: "nxp,lpc84x-syscon"

include: [clock-controller.yaml, base.yaml]

properties:
    reg:
      required: true

    "#clock-cells":
      const: 1

clock-cells:
  - name
```

## dts/bindings/gpio/nxp,lpc84x-gpio.yaml
```yaml
description: LPC84X GPIO node

compatible: "nxp,lpc84x-gpio"

include: [gpio-controller.yaml, base.yaml]

properties:
    reg:
      required: true

    "#gpio-cells":
      const: 2

    port:
      type: int
      required: true
      description: The GPIO port this node describes
      enum:
        - 0
        - 1

gpio-cells:
  - pin
  - flags
```

## dts/bindings/lin/lin-controller.yaml
```yaml
include: base.yaml

bus: lin

properties:
    bitrate:
      type: int
      required: true
      description: Initial bitrate to communicate at
```

## dts/bindings/lin/virtual,lin-uart.yaml
```yaml
description: Virtual LIN UART driver

compatible: "virtual,lin-uart"

include: lin-controller.yaml

properties:
    max-wait-percent:
      type: int
      default: 140
      description: Duration as percent of nominal transmission time to allow space between bytes (LIN 2.2A spec is 40% additional)
```

## dts/bindings/lin/zephyrboards,lin-uart.yaml
```yaml
description: Zephyrboards LIN UART driver

compatible: "zephyrboards,lin-uart"

include: lin-controller.yaml

properties:
    max-wait-percent:
      type: int
      default: 140
      description: Duration as percent of nominal transmission time to allow space between bytes (LIN 2.2A spec is 40% additional)
```

## dts/bindings/sdhc/nxp,mcux-sdhc.yaml
```yaml
description: NXP MCUX SD host controller

compatible: "nxp,mcux-sdhc"

include: [sdhc.yaml, pinctrl-device.yaml]

properties:
  reg:
    required: true

  interrupts:
    required: true

  clocks:
    required: true

  pinctrl-0:
    required: true

  pinctrl-names:
    required: true
```

## dts/bindings/serial/nxp,lpc84x-uart.yaml
```yaml
description: LPC84X UART node

compatible: "nxp,lpc84x-uart"

include: uart-controller.yaml

properties:
  reg:
    required: true

  clk:
    type: array
    required: true

  swm:
    type: array
    required: true

  pinctrl:
    type: array
    required: true
```

## dts/bindings/swm/nxp,lpc84x-swm.yaml
```yaml
description: LPC84X SWM node

compatible: "nxp,lpc84x-swm"

include: [base.yaml]

properties:
    reg:
      required: true

    clocks:
      required: true
```

## dts/bindings/tcpc/wch,ch32-ucpd.yaml
```yaml
description: CH32 USB PD Device Controller

compatible: "wch,ch32-ucpd"

include: base.yaml

properties:
  reg:
    required: true

  irq:
    type: array
    required: true

  clk:
    type: array
    required: true
```

## dts/bindings/usb/wch,ch32-usbfs.yaml
```yaml
description: CH32 USBFS Device Controller

compatible: "wch,ch32-usbfs"

include: usb-ep.yaml

properties:
  reg:
    required: true

  irq:
    type: array
    required: true

  clk:
    type: array
    required: true
```

## samples/fakeusbdrive/fakedisk/Kconfig
```kconfig
config DISK_DRIVER_FAKE
    bool "Enable fake disk driver"

if DISK_DRIVER_FAKE

config DISK_FAKE_VOLUME_NAME
    string "Fake disk mount point or drive name (FATFS needs existing ones)"
    default "FAKE"

config DISK_FAKE_SECTOR_COUNT
    int "Fake disk number of sectors"
    default 4294967295

module = FAKEDISK
module-str = fakedisk
source "subsys/logging/Kconfig.template.log_config"

endif # DISK_DRIVER_FAKE
```
