## boards/arm/nogusb/nogusb_defconfig
```kconfig
CONFIG_SOC_SERIES_STM32G0X=y
CONFIG_SOC_STM32G0B1XX=y

CONFIG_ARM_MPU=y

CONFIG_SERIAL=y
CONFIG_CONSOLE=y
CONFIG_UART_CONSOLE=y
CONFIG_UART_INTERRUPT_DRIVEN=y

CONFIG_PINCTRL=y

CONFIG_GPIO=y

CONFIG_CLOCK_CONTROL=y
```

## boards/arm/stm32_esc/Kconfig.defconfig
```kconfig
if BOARD_STM32_ESC

config BOARD
    default "stm32_esc"

endif # BOARD_STM32_ESC
```

## boards/arm/stm32_esc/stm32_esc_defconfig
```kconfig
CONFIG_SOC_SERIES_STM32F1X=y
CONFIG_SOC_STM32F103XB=y

CONFIG_CLOCK_CONTROL=y
CONFIG_PINCTRL=y

CONFIG_SERIAL=y
CONFIG_CONSOLE=y
CONFIG_UART_CONSOLE=y

CONFIG_GPIO=y
```

## boards/nxp/lpc845brk/Kconfig.lpc845brk
```kconfig
config BOARD_LPC845BRK
    select SOC_LPC845
    select SOC_PART_NUMBER_LPC845M301JBD48
```

## boards/others/6wire/6wire_defconfig
```kconfig
CONFIG_SOC_ATMEL_SAMD_XOSC32K=y
CONFIG_SOC_ATMEL_SAMD_XOSC32K_AS_MAIN=y

CONFIG_SERIAL=y
CONFIG_CONSOLE=y
CONFIG_UART_CONSOLE=y

CONFIG_GPIO=y

CONFIG_BUILD_OUTPUT_HEX=y
```

## boards/others/efm32wg/Kconfig.defconfig
```kconfig
if BOARD_EFM32WG

config CMU_HFXO_FREQ
    default 48000000

config CMU_LFXO_FREQ
    default 32768

config CMU_HFRCO_FREQ
    default 14000000

endif # BOARD_EFM32WG
```

## boards/others/efm32wg/board.yml
```yaml
board:
  name: efm32wg
  vendor: others
  socs:
  - name: efm32wg990f256 # actually efm32wg332f256
```

## boards/others/jabican_usb_pro/Kconfig.jabican_usb_pro
```kconfig
config BOARD_JABICAN_USB_PRO
    select SOC_MK22F51212
    select SOC_PART_NUMBER_MK22FN512VLH12
```

## boards/others/jabican_usb_pro/board.yml
```yaml
board:
  name: jabican_usb_pro
  vendor: others
  socs:
    - name: mk22f51212 # actually mk22f1m0avlh12
```

## boards/others/jabican_usb_pro/jabican_usb_pro_defconfig
```kconfig
CONFIG_SYS_CLOCK_HW_CYCLES_PER_SEC=120000000
CONFIG_OSC_LOW_POWER=y

CONFIG_SERIAL=y
CONFIG_CONSOLE=y
CONFIG_UART_CONSOLE=y

CONFIG_BUILD_OUTPUT_HEX=y
CONFIG_BOOTLOADER_MCUBOOT=y
CONFIG_MCUBOOT_SIGNATURE_KEY_FILE="bootloader/mcuboot/root-rsa-2048.pem"
# dfu-util -D build/zephyr/zephyr.signed.bin
```

## boards/others/k66f_breakout/Kconfig.defconfig
```kconfig
if BOARD_K66F_BREAKOUT

config OSC_XTAL0_FREQ
    default 12000000

config MCG_PRDIV0
    default 0x0

config MCG_VDIV0
    default 0x4

# MCGOUTCLK = 12MHz/1*30/2 = 180MHz

if NETWORKING

config NET_L2_ETHERNET
    default y if !MODEM

config ETH_MCUX_RMII_EXT_CLK
    default y

endif # NETWORKING

endif # BOARD_K66F_BREAKOUT
```

## boards/others/k66f_usbhs/Kconfig.k66f_usbhs
```kconfig
config BOARD_K66F_USBHS
    select SOC_MK66F18
    select SOC_PART_NUMBER_MK66FN2M0VMD18
```

## boards/others/k66f_usbhs/k66f_usbhs_defconfig
```kconfig
CONFIG_OSC_LOW_POWER=y

# TODO allow USB HS and SDHC access and enable
CONFIG_ARM_MPU=n
CONFIG_HW_STACK_PROTECTION=n

CONFIG_SERIAL=y
CONFIG_CONSOLE=y
CONFIG_UART_CONSOLE=y

CONFIG_BUILD_OUTPUT_HEX=y
CONFIG_BOOTLOADER_MCUBOOT=y
CONFIG_MCUBOOT_SIGNATURE_KEY_FILE="bootloader/mcuboot/root-rsa-2048.pem"
# dfu-util -D build/zephyr/zephyr.signed.bin
```

## boards/others/leveler/leveler_defconfig
```kconfig
CONFIG_SYS_CLOCK_HW_CYCLES_PER_SEC=72000000
CONFIG_ARM_MPU=y
CONFIG_HW_STACK_PROTECTION=y
CONFIG_CLOCK_CONTROL=y
CONFIG_PINCTRL=y

CONFIG_SERIAL=y
CONFIG_CONSOLE=y
CONFIG_UART_CONSOLE=y

CONFIG_GPIO=y
```

## boards/others/lpc845_lin/Kconfig.lpc845_lin
```kconfig
config BOARD_LPC845_LIN
    select SOC_LPC845
    select SOC_PART_NUMBER_LPC845M301JHI33
```
