## boards/others/lpc845_lin/lpc845_lin_defconfig
```kconfig
CONFIG_SYS_CLOCK_HW_CYCLES_PER_SEC=30000000

CONFIG_SERIAL=y
CONFIG_CONSOLE=y
CONFIG_UART_CONSOLE=y

CONFIG_GPIO=y

CONFIG_BUILD_OUTPUT_HEX=y
```

## boards/others/nogusb/nogusb_defconfig
```kconfig
CONFIG_ARM_MPU=y
CONFIG_CLOCK_CONTROL=y
CONFIG_PINCTRL=y
CONFIG_USBC_TCPC_DRIVER=y

CONFIG_SERIAL=y
CONFIG_CONSOLE=y
CONFIG_UART_CONSOLE=y

CONFIG_GPIO=y

CONFIG_BUILD_OUTPUT_HEX=y
CONFIG_BOOTLOADER_MCUBOOT=y
CONFIG_MCUBOOT_SIGNATURE_KEY_FILE="bootloader/mcuboot/root-rsa-2048.pem"
# dfu-util -D build/zephyr/zephyr.signed.bin
```

## boards/others/stm32_esc/stm32_esc_defconfig
```kconfig
CONFIG_CLOCK_CONTROL=y
CONFIG_PINCTRL=y

CONFIG_SERIAL=y
CONFIG_CONSOLE=y
CONFIG_UART_CONSOLE=y

CONFIG_GPIO=y
```

## boards/riscv/usb_pdmon/Kconfig.defconfig
```kconfig
if BOARD_USB_PDMON

config BOARD
    default "usb_pdmon"

endif # BOARD_USB_PDMON
```

## boards/riscv/usb_pdmon/usb_pdmon_defconfig
```kconfig
CONFIG_BOARD_USB_PDMON=y

# workaround for now, see wch_ch32/common/irq.c
CONFIG_TRACING=y
CONFIG_TRACING_USER=y

CONFIG_SERIAL=y
CONFIG_CONSOLE=y
CONFIG_UART_CONSOLE=y

CONFIG_GPIO=y

# enable USB PD
CONFIG_ADC=y
CONFIG_USBC_TCPC_DRIVER=y
CONFIG_USBC_VBUS_DRIVER=y
```

## drivers/Kconfig
```kconfig
menu "zephyrboards drivers"

rsource "adc/Kconfig"
rsource "gpio/Kconfig"
rsource "lin/Kconfig"
rsource "serial/Kconfig"
rsource "usb/Kconfig"
rsource "usb_c/Kconfig"

endmenu
```

## drivers/adc/Kconfig
```kconfig
if ADC

rsource "Kconfig.ch32"

config ADC_INIT_PRIORITY
    int "ADC init priority"
    default KERNEL_INIT_PRIORITY_DEFAULT

endif # ADC
```

## drivers/adc/Kconfig.ch32
```kconfig
menuconfig ADC_CH32
    bool "CH32 ADC driver"
    default y
    depends on DT_HAS_WCH_CH32_ADC_ENABLED
```

## drivers/clock_control/Kconfig
```kconfig
if CLOCK_CONTROL

# idk why not set
config CLOCK_CONTROL_INIT_PRIORITY
  int "Clock control init priority"
  default KERNEL_INIT_PRIORITY_OBJECTS

rsource "Kconfig.lpc84x"

endif # CLOCK_CONTROL
```

## drivers/clock_control/Kconfig.lpc84x
```kconfig
menuconfig CLOCK_CONTROL_LPC84X
    bool "LPC84X Reset and clock control"
    depends on SOC_SERIES_LPC84X
    help
      Enable driver for reset and clock control used in
      LPC84X MCUs

if CLOCK_CONTROL_LPC84X

endif # CLOCK_CONTROL_LPC84X
```

## drivers/gpio/Kconfig
```kconfig
if GPIO

rsource "Kconfig.ch32"
rsource "Kconfig.lpc84x"

config GPIO_INIT_PRIORITY
    int "GPIO init priority"
    default KERNEL_INIT_PRIORITY_DEFAULT

endif # GPIO
```

## drivers/gpio/Kconfig.ch32
```kconfig
menuconfig GPIO_CH32
    bool "CH32 GPIO driver"
    default y
    depends on DT_HAS_WCH_CH32_GPIO_ENABLED
```

## drivers/gpio/Kconfig.lpc84x
```kconfig
menuconfig GPIO_LPC84X
    bool "LPC84X GPIO driver"
    depends on SOC_SERIES_LPC84X
```

## drivers/lin/Kconfig
```kconfig
#
# LIN options
#
menuconfig LIN
    bool "LIN Drivers"
    help
      Enable LIN Driver Configuration

if LIN

module = LIN
module-str = LIN
source "subsys/logging/Kconfig.template.log_config"

config LIN_INIT_PRIORITY
  int "LIN driver init priority"
  default KERNEL_INIT_PRIORITY_DEVICE
  help
    LIN driver device initialization priority.

rsource "Kconfig.uart"

endif # LIN
```

## drivers/lin/Kconfig.uart
```kconfig
DT_COMPAT_VIRTUAL_LIN_UART := virtual,lin-uart

config LIN_UART
  bool "LIN protocol over UART"
  default $(dt_compat_enabled,$(DT_COMPAT_VIRTUAL_LIN_UART))
  select UART_INTERRUPT_DRIVEN
  help
    Enable the LIN UART driver
```

## drivers/sdhc/Kconfig.mcux_sdhc
```kconfig
menuconfig MCUX_SDHC
    bool "NXP MCUX SDHC driver"
    default y
    depends on DT_HAS_NXP_MCUX_SDHC_ENABLED
    select SDHC_SUPPORTS_NATIVE_MODE
    select PINCTRL
```
